## aicos/os/osa/common/Kconfig
```kconfig
menu "Common Config"
    config PLAT_PRINTF
        bool "Printf Function Enable"
        default y
        help
          Enable the printf function.

    config AIC_OSA
        bool "AIC OSA Enable"
        default y
        help
          Enable AIC OSA function.

    config FSMMSG_FEATURE
        bool "FSMMSG Enable"
        default n
        help
          Enable The FSMMSG Feature.

    config OSA_RMTE_MSG
        bool "Remote msg support"
        depends on AIC_OSA
        default n
        help
          Enable The Remote MSG Feature.

    config FILENAME_TO_ID
        bool "Enable filename convert to file id."
        default n
        help
          Enable filename convert to file id.

    config ASSERT_FEWER_PARAM
        bool "Enable assert pass fewer param."
        default n
        help
          Enable it can decrease the code size.

    config AOS_INT_DEBUG
        bool "AIC OSA interrupt debug"
        depends on AIC_OSA
        default n
        help
          Enable AIC OSA interrupt debug.

    config AIC_OSA_TEST
        bool "AIC OSA TEST Enable"
        depends on AIC_OSA
        default n
        help
          Enable AIC OSA test function.

    config CUSTOMER_MEM_LAYOUT
        bool "Enable Customer Memory Layout"
        default n
        help
          Enable Customer Memory Layout.

    config RTOS_THREADX
        bool "RTOS Threadx Enable"
        depends on AIC_OSA
        default y
        help
          Enable RTOS Threadx.

    config RTOS_LITEOS_M
        bool "RTOS Liteos-m"
        depends on !RTOS_THREADX && AIC_OSA
        default n
        help
          Enable RTOS Liteos-m.

    config MEM_MODE_TLSF
        bool "TLSF Memory Mode Enable"
        default n
        help
          Enable TLSF Memory Mode.

    config MEM_BLOCK_POOL
        bool "Enable Block Pool"
        default n
        help
          Enable Block Pool Support.

    config TX_CMSIS
        bool "Enable CMSIS-RTOSv2 API Adaptation Layer for ThreadX"
        default n
        help
          Enable CMSIS-RTOSv2 API Adaptation Layer for ThreadX.

endmenu
```

## aicos/os/osa/rae_libc/Kconfig
```kconfig
menu "Reent and ext libc Config"
    config PLAT_RAC_LIBC
        bool "Reent and ext LIBC Enable"
        depends on COMPILER_GCC
        default y
        help
          Enable reent and ext LIBC. 

    config PLAT_RAC_LIBC_MEM
        bool "Reent and ext mem api"
        depends on PLAT_RAC_LIBC
        default n
        help
          Enable use the Reent and ext mem api.

    config PLAT_RAC_LIBC_TIME
        bool "Reent and ext LIBC time api"
        depends on PLAT_RAC_LIBC
        default y
        help
          Enable use the Reent and ext libc time api.
endmenu
```

## aicos/os/osa/rom_call/Kconfig
```kconfig
menu "Rom Function Call Support Config"
    config ROM_CALL_SUPPORT
        bool "Rom Function Call Support Enable"
        default n
        help
          Enable Rom Function Call Suppor. 
    config ROM_BIN_BUILD
        bool "Build For Rom Bin"
        depends on ROM_CALL_SUPPORT
        default n
        help
          Enable Build For Rom Bin.

endmenu
```

## aicos/vendors/Kconfig
```kconfig
# General configuration options
#
# Copyright 2023 by AICXTEK TECHNOLOGIES CO.,LTD. All rights reserved.

menuconfig VENDORS
    bool "Vendor Component Configurations"
    depends on SUBSYS_AP
    help
      Enable config options for Vendors.

if VENDORS
config JC_NETWORK_VIDEO_CALL
    bool "JC network video call"
    depends on CAMERA_VIDEO_SUPPORT && JPEG_SUPPORT
    default n

config SSV_WIFI
    bool "ssv wifi module"
    depends on USE_NETXDUO
    default n

config BK7238
    bool "BK7238 wifi module"
    depends on USE_NETXDUO
    default n

config FOTA_SUPPORT_ABUP
    bool "abup fota"
    depends on SUBSYS_AP
    default n

config TTS_IFLY
    bool "TTS IFLY"
    depends on AUDIO_SUPPORT
    default n

config TC_IOT_VIDEO
    bool "TC IOT VIDEO"
    depends on SUBSYS_AP
    default n
endif
```

## bootloader/drivers/bcd/Kconfig
```kconfig
# General configuration options
#
# Copyright 2022 by AICXTEK TECHNOLOGIES CO.,LTD. All rights reserved.
# power suppley battery charging detect configurations

menuconfig BCD
    bool "battery charging detect driver."
    default n
    help
        battery charging detect driver(no-dcd\ps2\sdp\cdp\dcp).

if BCD
    #PMIC bcd Selection configurations
    choice
        prompt "bc1.2 driver Selection"
        default BCD_R1P0

        config BCD_R1P0
            bool "R1P0 bc1.2 ip"
            help
                select bc1.2 r1p0 for bcd interface.

        config BCD_R2P0
            bool "R2P0 bc1.2 ip"
            help
                select bc1.2 r2p0 for bcd interface.
    endchoice

    config BCD_DUMMY
        bool "bcd dummy interface"
        default n
        help
            select dummy for bcd interface.

    if BCD_R1P0
        config BCD_IP
            string
            default "r1p0"
    endif

    if BCD_R2P0
        config BCD_IP
            string
            default "r2p0"
    endif

    config BCD_DEMO
        bool "bcd user demo."
        default n
        help
            bcd user demo.
endif
```
