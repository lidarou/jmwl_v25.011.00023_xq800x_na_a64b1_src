## aicos/components/wifi/wifi_scan/Kconfig
```kconfig
# General configuration options
#
# Copyright 2022 by AICXTEK TECHNOLOGIES CO.,LTD. All rights reserved.

config WIFI_SCAN
    bool "Wifi Scan Support"
    depends on SUBSYS_AP
    default n
    help
      Enable config for wifi scan.
```

## aicos/drivers/Kconfig
```kconfig
# General configuration options
#
# Copyright 2021 by AICXTEK TECHNOLOGIES CO.,LTD. All rights reserved.

menu "Drivers Options"

#source core arch Kconfig
source "drivers/arch/*/Kconfig"

#source other driver components Kconfig
source "drivers/adrmap/Kconfig"
source "drivers/cpremap/Kconfig"
source "drivers/ambox/Kconfig"
source "drivers/busmonitor/Kconfig"
source "drivers/clk/Kconfig"
source "drivers/coresight/Kconfig"
source "drivers/crypto/Kconfig"
source "drivers/debug/Kconfig"
source "drivers/dma/Kconfig"
source "drivers/efuse/Kconfig"
source "drivers/eipu/Kconfig"
source "drivers/fmd/Kconfig"
source "drivers/gpd/Kconfig"
source "drivers/gpio/Kconfig"
source "drivers/gpo/Kconfig"
source "drivers/graphics/Kconfig"
source "drivers/hlzma/Kconfig"
source "drivers/i2c/Kconfig"
source "drivers/iis/Kconfig"
source "drivers/ipu/Kconfig"
source "drivers/kpc/Kconfig"
source "drivers/lzma/Kconfig"
source "drivers/misc/Kconfig"
source "drivers/modem_sys/Kconfig"
source "drivers/network/Kconfig"
source "drivers/pcdump/Kconfig"
source "drivers/pin_ctrl/Kconfig"
source "drivers/pmic/Kconfig"
source "drivers/pmic_i2c/Kconfig"
source "drivers/psram/Kconfig"
source "drivers/pwm/Kconfig"
source "drivers/qspi/Kconfig"
source "drivers/sdmmc/Kconfig"
source "drivers/serial/Kconfig"
source "drivers/sleep/Kconfig"
source "drivers/sound/Kconfig"
source "drivers/spinlock/Kconfig"
source "drivers/sysoff/Kconfig"
source "drivers/subsys/Kconfig"
source "drivers/timer/Kconfig"
source "drivers/usb/Kconfig"
source "drivers/wdt/Kconfig"
source "drivers/ssp/Kconfig"
source "drivers/thermc/Kconfig"
source "drivers/cmux/Kconfig"
source "drivers/ext_modem/Kconfig"
source "drivers/mha/Kconfig"
osource "drivers/can/Kconfig"
osource "drivers/dmc_mpu/Kconfig"
osource "drivers/example/Kconfig"
osource "drivers/perf/Kconfig"
osource "drivers/zjtag/Kconfig"
osource "drivers/zz_test/Kconfig"
osource "drivers/trng/Kconfig"
osource "drivers/bb_cali/Kconfig"
endmenu # Drivers Options
```

## aicos/drivers/adrmap/Kconfig
```kconfig
# General configuration options
#
# Copyright 2022 by AICXTEK TECHNOLOGIES CO.,LTD. All rights reserved.

menuconfig ADRMAP
    bool "ADRMAP Drivers"
    depends on SUBSYS_CP
    help
      Enable config options for adrmap drivers.

if ADRMAP

config ADRMAP_DRIVER
    bool "ADRMAP module driver"
    default n
    help
      adrmap module driver.

endif # ADRMAP
```

## aicos/drivers/ambox/Kconfig
```kconfig
# General configuration options
#
# Copyright 2021 by AICXTEK TECHNOLOGIES CO.,LTD. All rights reserved.

menu "AMBOX Drivers"

config DRIVER_AMBOX
    bool "aic mailbox driver"
    default y

config ENABLE_AMBOX_SW_FIFO
    bool "enable ambox sw fifo"
    default n
    depends on DRIVER_AMBOX
    help
      Enable ambox software mail fifo.

choice
    prompt "Select mailbox driver"
    default DRIVER_AMBOX_R1PX
config DRIVER_AMBOX_R1PX
    bool "aic mailbox ip version r1px"
    depends on DRIVER_AMBOX
    help
      Select aic mailbox ip version r1px
endchoice

config DRIVER_AMBOX_PHY
    bool "enable ambox phy"
    default n
    depends on DRIVER_AMBOX
    help
      Enable ambox phy.
      if disable it, will simulator ambox phy by software.

endmenu # AMBOX Driver
```

## aicos/drivers/arch/arm/Kconfig
```kconfig
# General configuration options
#
# Copyright 2021 by AICXTEK TECHNOLOGIES CO.,LTD. All rights reserved.

config CPU_ARCH_ARM
    bool "Select ARM architecture"
    help
      Select ARM cpu arch.

config CPU_ARCH_ARM64
    bool
    help
      Select ARM64 cpu arch.

config CPU_ARCH_RISCV
    bool
    help
      Select RISCV cpu arch.

# arm components configurations
config CPU_CORTEX_M33
    bool
    select ISA_THUMB2
    help
      This option signifies the use of a Cortex-M33 CPU

config CPU_CORTEX_M55
    bool
    help
      This option signifies the use of a Cortex-M55 CPU

config CPU_CORTEX_M7
    bool
    select ISA_THUMB2
    help
      Select the cpu core as Cortex M7

config CPU_CORTEX_MSTAR
    bool "Select CPU Cortex MStar"
    select ISA_THUMB2
    help
      Select the cpu core as Cortex MSTAR

config CPU_CORTEX_R4
    bool
    help
      This option signifies the use of a Cortex-R4 CPU

config CPU_CORTEX_R5
    bool "Select CPU Cortex Cortex R5"
    select ISA_THUMB2
    help
      This option signifies the use of a Cortex-R5 CPU

config CPU_CORTEX_R7
    bool
    help
      This option signifies the use of a Cortex-R7 CPU

config TCM_ENABLE
    bool "Enable cp tcm"
    depends on SUBSYS_CP
    default y
    help
      Enable the tcm function.

config GEN_TCM_BIN
    bool "Generate tcm bin"
    depends on TCM_ENABLE
    default n
    help
      Generate tcm bins.

config TCM_ROM_DEBUG_AS_RAM
    bool "TCM rom debug as ram"
    depends on TCM_ENABLE
    default n
    help
      Only can open on fpga for atcm rom and btcm rom debug.
      if open it, will complie the atcm rom and btcm rom as ram
      and increase the atcm/btcm ram size.

config TCM_MAP_NEQ_LOAD
    bool "Map region not equal load region"
    depends on TCM_ENABLE
    default n
    help
      The map region and the load region are not equal.

config ARMV8_M_DSP
    bool "ARMv8m DSP"
    depends on SUBSYS_AP
    default n
    help
      ARMv8 arch contrexM DSP.

config ISA_THUMB2
    bool
    help
      From: http://www.arm.com/products/processors/technologies/instruction-set-architectures.php

      Thumb-2 technology is the instruction set underlying the ARM Cortex
      architecture which provides enhanced levels of performance, energy
      efficiency, and code density for a wide range of embedded
      applications.

      Thumb-2 technology builds on the success of Thumb, the innovative
      high code density instruction set for ARM microprocessor cores, to
      increase the power of the ARM microprocessor core available to
      developers of low cost, high performance systems.

      The technology is backwards compatible with existing ARM and Thumb
      solutions, while significantly extending the features available to
      the Thumb instructions set. This allows more of the application to
      benefit from the best in class code density of Thumb.

      For performance optimized code Thumb-2 technology uses 31 percent
      less memory to reduce system cost, while providing up to 38 percent
      higher performance than existing high density code, which can be used
      to prolong battery-life or to enrich the product feature set. Thumb-2
      technology is featured in the  processor, and in all ARMv7
      architecture-based processors.

config ISA_ARM
    bool
    help
      From: https://developer.arm.com/products/architecture/instruction-sets/a32-and-t32-instruction-sets

      A32 instructions, known as Arm instructions in pre-Armv8 architectures,
      are 32 bits wide, and are aligned on 4-byte boundaries. A32 instructions
      are supported by both A-profile and R-profile architectures.

      A32 was traditionally used in applications requiring the highest
      performance, or for handling hardware exceptions such as interrupts and
      processor start-up. Much of its functionality was subsumed into T32 with
      the introduction of Thumb-2 technology.

config ASSEMBLER_ISA_THUMB2
    bool
    default y if ISA_THUMB2 && !ISA_ARM
    depends on !ISA_ARM
    help
      This helper symbol specifies the default target instruction set for
      the assembler.

      When only the Thumb-2 ISA is supported (i.e. on Cortex-M cores), the
      assembler must use the Thumb-2 instruction set.

      When both the Thumb-2 and ARM ISAs are supported (i.e. on Cortex-A
      and Cortex-R cores), the assembler must use the ARM instruction set
      because the architecture assembly code makes use of the ARM
      instructions.

config COMPILER_ISA_THUMB2
    bool "Select compiler isa thumb2 support"
    depends on ISA_THUMB2
    default y
    help
      This option configures the compiler to compile all C/C++ functions
      using the Thumb-2 instruction set.

      N.B. The scope of this symbol is not necessarily limited to the C and
           C++ languages; in fact, this symbol refers to all forms of
           "compiled" code.

           When an additional natively-compiled language support is added
           in the future, this symbol shall also specify the Thumb-2
           instruction set for that language.
```

## aicos/drivers/bb_cali/Kconfig
```kconfig
config AIC_BB_CALI
    bool "aic bb cali module"
    default n
    help
      "enable aic bb cali module"
```

## aicos/drivers/busmonitor/Kconfig
```kconfig
# General configuration options
#
# Copyright 2022 by AICXTEK TECHNOLOGIES CO.,LTD. All rights reserved.

menuconfig BUSMON
    bool "BUSMON Drivers"
    default n
    help
      Enable config options for bus monitor drivers.

if BUSMON

config DRIVER_BUSMON
    bool "BusMonitor module"
    help
      BusMonitor module.

config DRIVER_PERF
    bool "Performance Monitor"
    depends on SUBSYS_AP
    help
      Performance Monitor module.

config DRIVER_BUSMON_VER
    string "Bus monitor driver IP version"
    depends on DRIVER_BUSMON || DRIVER_PERF
    default "r1p0"
    help
      Bus monitor IP version, different chip will use different version
      of bus monitor IP.

config DRIVER_TRANS_MON
    bool "Transfer Monitor"
    depends on DRIVER_BUSMON
    help
      Transfer Monitor module for debug bus.

endif # BUSMON
```

## aicos/drivers/can/Kconfig
```kconfig
# General configuration options
#
# Copyright 2021 by AICXTEK TECHNOLOGIES CO.,LTD. All rights reserved.
# lzma software decoder configurations
#

menuconfig CAN
    bool "CAN Drivers"
    depends on SUBSYS_AP
    help
      Enable config options for CAN drivers.

if CAN

config DRIVER_CAN
    bool "CAN Driver"
    default n

config DRIVER_CAN_TEST
    bool "CAN Driver Test"
    depends on DRIVER_CAN
    default n

endif
```

## aicos/drivers/clk/Kconfig
```kconfig
# General configuration options
#
# Copyright 2021 by AICXTEK TECHNOLOGIES CO.,LTD. All rights reserved.

menu "Clock Drivers"

config AIC_CLK
    bool "AIC Clock"
    default y

choice
    prompt "Select driver type"
    default AIC_IOT_CLK
config AIC_IOT_CLK
    bool "aic iot clock driver"
    depends on AIC_CLK
    help
      Select iot clock driver

config AIC_STANDARD_CLK
    bool "aic standard clock driver"
    depends on AIC_CLK
    help
      Select standard clock driver
endchoice

endmenu # Clock Driver
```

## aicos/drivers/cmux/Kconfig
```kconfig
# General configuration options
#
# Copyright 2022 by AICXTEK TECHNOLOGIES CO.,LTD. All rights reserved.

menu "CMUX Drivers"

config CMUX
    bool "CMUX Drivers"
    depends on SUBSYS_AP
    help
      Enable config options for CMUX drivers.

config CMUX_PRIORITY
    bool "CMUX priority"
    depends on CMUX
    help
      Cmux config for priority.

choice
    prompt "cmux version selection"
    default CMUX_R1P0

    config CMUX_R1P0
        bool "r1p0"
    depends on CMUX
        help
            gx31x cmux

    config CMUX_R2P0
        bool "r2p0"
    depends on CMUX
        help
            gx30x cmux
endchoice

if CMUX_R1P0
    config CMUX_VERSION
        string
        default "r1p0"
endif

if CMUX_R2P0
    config CMUX_VERSION
        string
        default "r2p0"
endif
endmenu # CMUX Driver
```

## aicos/drivers/coresight/Kconfig
```kconfig
# General configuration options
#
# Copyright 2022 by AICXTEK TECHNOLOGIES CO.,LTD. All rights reserved.

menuconfig CORESIGHT
    bool "CORESIGHT Drivers"
    help
      Enable config options for coresight drivers.

if CORESIGHT

config DRIVER_CORESIGHT
    bool "Coresight driver"
    default n
    help
      Coresight components, use for coresight trace debug.

config DRIVER_CORESIGHT_MTB
    bool "MTB driver"
    depends on CPU_CORTEX_MSTAR && DRIVER_CORESIGHT
    default n
    help
      MTB IP, use for CMStar trace debug.

endif # CORESIGHT
```

## aicos/drivers/cpremap/Kconfig
```kconfig
# General configuration options
#
# Copyright 2022 by AICXTEK TECHNOLOGIES CO.,LTD. All rights reserved.

menuconfig CPREMAP
    bool "CP Remap Drivers"
    default n
    help
      Enable config options for cpremap drivers.

if CPREMAP

config CPREMAP_DRIVER
    bool "cp remap module driver"
    default n
    help
      cpremap module driver.

config CP_PSRAM_REMAP
    bool "Enable cp psram remap"
    default n
    depends on CPREMAP_DRIVER
    help
      Enable cp psram remap.

config CP_IRAM_REMAP
    bool "Enable cp iram remap"
    default n
    depends on CPREMAP_DRIVER
    help
      Enable cp iram remap.

config CP_REMAP_DIS_MDM
    bool "Disable the modem remap"
    default n
    depends on CPREMAP_DRIVER
    help
      Disable the cp modem remap function.

endif # CPREMAP
```

## aicos/drivers/crypto/Kconfig
```kconfig
menu "Crypto Component Configurations"

config CRYPTO
    bool "Crypto Component configurations"
    default n


config EIP130_DDK_3_1
    bool "EIP130 DDK lib support"
    depends on CRYPTO
    default n


endmenu # Crypto Component Configurations
```

## aicos/drivers/debug/Kconfig
```kconfig
# General configuration options
#
# Copyright 2022 by AICXTEK TECHNOLOGIES CO.,LTD. All rights reserved.

menuconfig CHIP_DEBUG
    bool "Chip debug modules"
    help
      Enable config options for chip debug modules.

source "drivers/debug/*/Kconfig"
```

## aicos/drivers/debug/breakpoint/Kconfig
```kconfig
# General configuration options
#
# Copyright 2022 by AICXTEK TECHNOLOGIES CO.,LTD. All rights reserved.

config DRIVER_BREAKPOINT
    bool "Breakpoint driver"
    depends on CHIP_DEBUG
    default n
    help
      Configure breakpoint in source code.
```

## aicos/drivers/debug/dbg_bus/Kconfig
```kconfig
# General configuration options
#
# Copyright 2022 by AICXTEK TECHNOLOGIES CO.,LTD. All rights reserved.

config DRIVER_DBGBUS
    bool "Debug bus driver"
    depends on SUBSYS_AP
    depends on CHIP_DEBUG
    default n
    help
      Output debug bus info.
```

## aicos/drivers/debug/dump_addr/Kconfig
```kconfig
# General configuration options
#
# Copyright 2022 by AICXTEK TECHNOLOGIES CO.,LTD. All rights reserved.

config DRIVER_DUMPADDR
    bool "Dump address driver"
    depends on SUBSYS_AP
    depends on CHIP_DEBUG
    default n
    help
      Dump address in console.
```

## aicos/drivers/dma/Kconfig
```kconfig
# General configuration options
#
# Copyright 2022 by AICXTEK TECHNOLOGIES CO.,LTD. All rights reserved.

menuconfig DMA
    bool "DMA Drivers"
    help
      Enable config options for DMA drivers.

if DMA

config DRIVER_DMA
    bool "Driver DMA"
    default n
    help
      DMA IP, use for memory copy

config DRIVER_DMA_VER
    string "DMA IP version"
    depends on DRIVER_DMA
    default "r1p0"
    help
      DMA IP version, different chip will use different version DMA IP.

endif # DMA
```

## aicos/drivers/dmc_mpu/Kconfig
```kconfig
# General configuration options
#
# Copyright 2022 by AICXTEK TECHNOLOGIES CO.,LTD. All rights reserved.

menu "DMC MPU SoC Drivers"

config DRIVER_DMC_MPU
    bool "DMC MPU module"
    depends on SUBSYS_AP
    help
      DMC MPU module.

config DRIVER_DMC_MPU_VER
    string "DMC MPU driver IP version"
    depends on DRIVER_DMC_MPU
    default "r1p0"
    help
      DMC MPU IP version, different chip will use different version
      of DMC MPU IP.

endmenu # DMC MPU SoC Drivers
```
