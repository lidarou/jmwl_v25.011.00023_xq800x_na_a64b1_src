## aicos/drivers/efuse/Kconfig
```kconfig
# General configuration options
#
# Copyright 2022 by AICXTEK TECHNOLOGIES CO.,LTD. All rights reserved.

menuconfig EFUSE
    bool "EFUSE Drivers"
    depends on SUBSYS_AP
    select DRIVER_EFUSE if SUBSYS_AP
    help
      Enable config options for EFUSE drivers.

if EFUSE

config DRIVER_EFUSE
    bool "Efuse driver"
    default y
    help
      SoC efuse operate driver.

config DRIVER_EFUSE_VER
    string "Efuse driver version"
    depends on DRIVER_EFUSE
    default "r1p0"
    help
      Select version that match witch SoC efuse IP.

config DRIVER_EFUSE_DEMO
    bool "efuse driver demo"
    depends on DRIVER_EFUSE
    default n
    help
      efuse driver demo for user.

choice
    prompt "UID version"
    default UID_GX316
    help
        SoC UID Version.

    config UID_GX316
        bool "gx316 uid"
endchoice

config UID_VERSION
    string
    default "gx316" if UID_GX316
endif # EFUSE
```

## aicos/drivers/eipu/Kconfig
```kconfig
# General configuration options
#
# Copyright 2021 by AICXTEK TECHNOLOGIES CO.,LTD. All rights reserved.

menuconfig EIPU
    bool "EIPU Drivers"
    default n
    help
      Enable config options for eipu drivers.

if EIPU

choice
    prompt "sleep controller selection"
    default EIPU_R1P0

    config EIPU_R1P0
        bool "eipu r1p0"
        help
            gx31x eipu

    config EIPU_R2P0
        bool "eipu r2p0"
        help
            gx30x eipu
endchoice

if EIPU_R1P0
    config EIPU_VERSION
        string
        default "r1p0"
endif

if EIPU_R2P0
    config EIPU_VERSION
        string
        default "r2p0"
endif

config EIPU_DRIVER
    bool "Driver EIPU module"
    default n
    help
      Select eipu module.

endif
```

## aicos/drivers/ext_modem/Kconfig
```kconfig
# General configuration options
#
# Copyright 2022 by AICXTEK TECHNOLOGIES CO.,LTD. All rights reserved.

menuconfig EXT_MODEM
    bool "EXT_MODEM support"
    default n
    help
      Enable config options for EXT_MODEM drivers.

if EXT_MODEM

config DRIVER_EXT_MODEM
    bool "EXT_MODEM driver"
    default n
    help
       use for get external modem configuration.

config DRIVER_EXT_MODEM_SPI_DEV
    bool "EXT_MODEM spi device driver"
    default n
    help
       use for enable EXT_MODEM spi device driver.
endif # GPIO
```

## aicos/drivers/fmd/Kconfig
```kconfig
# General configuration options
#
# Copyright 2021 by AICXTEK TECHNOLOGIES CO.,LTD. All rights reserved.
#

menuconfig FMD
    tristate "Flash Managemant Device (FMD) support"
    help
        FMD used for flash managemant.

if FMD

source "drivers/fmd/ftl/Kconfig"

source "drivers/fmd/snor/Kconfig"

endif
```

## aicos/drivers/fmd/ftl/Kconfig
```kconfig
# General configuration options
#
# Copyright 2021 by AICXTEK TECHNOLOGIES CO.,LTD. All rights reserved.
#

menuconfig FTL
    tristate "Flash translation layer (FTL) support"
    help
        FTL implements flash wear leveling and power loss protection.

if FTL

source "drivers/fmd/ftl/levelx/Kconfig"

endif
```
