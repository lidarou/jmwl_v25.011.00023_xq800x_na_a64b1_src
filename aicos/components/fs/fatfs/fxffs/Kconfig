## aicos/components/network/netxduo/Kconfig
```kconfig
# General configuration options
#
# Copyright 2021 by AICXTEK TECHNOLOGIES CO.,LTD. All rights reserved.

menu "Netxduo Configurations"
menu "Network Protocol"

config NET_PROTOCOL
    bool "Network application protocol"
    depends on AZURE_NETXDUO
    depends on NET_COMMON
    default y

config NET_SNTP
    bool "Supports SNTP"
    depends on NET_ADDONS && NET_PROTOCOL
    default n

config NET_HTTP
    bool "Supports HTTP"
    depends on NET_ADDONS && NET_PROTOCOL && NX_BSD
    default n

config NET_HTTPS
    bool "Supports HTTPS"
    select NET_HTTP
    depends on NET_TLS_API || CRYPTO_MBEDTLS
    depends on NET_ADDONS && NET_PROTOCOL
    default n

config NET_FTP
    bool "Supports FTP"
    depends on NET_ADDONS && NET_PROTOCOL
    depends on FS
    default n

config NET_FTPS
    bool "Supports FTPS"
    depends on NET_ADDONS && NET_PROTOCOL
    depends on NET_TLS_API || CRYPTO_MBEDTLS
    depends on FS
    select NET_FTP
    default n

config NET_MQTT
    bool "Supports MQTT"
    depends on NET_ADDONS && NET_PROTOCOL
    default n

config NET_MQTTS
    bool "Supports MQTTS"
    depends on NET_ADDONS && NET_PROTOCOL
    depends on NET_TLS_API || CRYPTO_MBEDTLS
    select NET_MQTT
    default n

config NET_LIBCOAP
    bool "Supports COAP"
    depends on NET_ADDONS && NET_PROTOCOL && NX_BSD
    default n

config NET_LWM2M
    bool "Supports LWM2M"
    depends on NET_ADDONS && NET_PROTOCOL
    default n
endmenu # Network Protocol

menu "Network Tethering"

config NET_SHARE_COMMON
    bool "Network Share"
    depends on AZURE_NETXDUO
    default n

menu "PPP Network module"
config PPP
    bool "PPP Network module"
    depends on NET_SHARE_COMMON && NET_COMMON
    select NET_ADDONS
    select PDP_MGR
    select NX_NAT
    select NET_IPV6_PACKET_ROUTER
    select NX_DHCP
    select NET_DRIVER
    default n

config PPP_DIAL
    bool "PPP Dial"
    depends on PPP
    default n

config NX_PPP
    bool "Point-to-Point Protocol(PPP)"
    depends on PPP
    default n

endmenu # PPP Network module

menu "Softap"

config SOFTAP_SHARE
    bool "SOFTAP Network Share"
    depends on NET_SHARE_COMMON && NET_COMMON
    select NX_NAT
    select NX_DHCP
    select NET_ADDONS
    select PDP_MGR
    select NET_IPV6_PACKET_ROUTER
    default n

endmenu # USB Tethering

menu "USB Tethering"

config USB_NET_SHARE
    bool "USB Network Share"
    depends on NET_SHARE_COMMON && NET_COMMON && NET_ADDONS
    select NX_NAT
    select NX_DHCP
    select PDP_MGR
    select NET_IPV6_PACKET_ROUTER
    default n

endmenu # USB Tethering

menu "USB SEMI Tethering"

config NET_SEMI_TETHER
    bool "USB Semi Tether"
    depends on NET_SHARE_COMMON && USB && NET_ADDONS
    depends on USBX_DEVICE
    select USBX_DEVICE_CLASS_CDC_ECM
    select CDC_ECM_INSTANCE
    select USBX_DEVICE_CLASS_RNDIS
    select RNDIS_INSTANCE
    select CDC_ECM_INSTANCE
    select NX_NAT
    select NX_DHCP
    select USBX_NETWORK
    default n
    help
        Say Y if you want to test usb share with LAN.

endmenu # USB SEMI Tethering

endmenu # Network Tethering

menu "Network Basic Configurations"

config AZURE_NETXDUO
    bool "NetWork Configurations"
    depends on USE_NETXDUO
    default y

menu "Network Kernel Configurations"

config NET_COMMON
    bool "net common component"
    depends on AZURE_NETXDUO
    select NET_NEW_PACKET_MANAGE
    select NET_EXTERNEL_API
    default n

config DISABLE_IPV4_ARP
    bool "disable ipv4 arp"
    depends on NET_COMMON
    default n

config DISABLE_IPV4_RARP
    bool "disable ipv4 rarp"
    depends on NET_COMMON
    default n

config NET_IPSEC
    bool "net ipsec component"
    depends on NET_COMMON
    select NET_CRYPTO_LITE_LIBRARIES
    default n

config NX_RAM_DRIVER
    bool "example ram ethernet driver"
    depends on NET_COMMON
    default n

config NET_EXTERNEL_API
    bool "net externel api component"
    depends on NET_COMMON
    default n

config NET_NEW_PACKET_MANAGE
    bool "aic new network packet management"
    depends on NET_COMMON
    default n

config NET_LOW_POWER
    bool "aic net_low power"
    depends on NET_COMMON
    default n

config NET_DRIVER_DIRECT_FORWARD
    bool "aic network driver direct forward"
    depends on NET_COMMON
    default n

config NET_IPV6_PACKET_ROUTER
    bool "aic network ipv6 packet router"
    depends on NET_COMMON
    default n

config NET_TRAFFIC_CONTROL
    bool "aic network traffic control"
    depends on NET_COMMON
    default n

config NET_NAT64
    bool "aic network NAT64"
    depends on NET_COMMON
    default n

config NET_IPSEC_TEST
    bool "net ipsec test component"
    depends on NET_IPSEC
    select NX_RAM_DRIVER
    default n

config NET_IPSEC_IPV4_UDP_TEST
    bool "net ipsec ipv4 udp test component"
    depends on NET_IPSEC_TEST
    default n

config NET_IPSEC_IPV4_TCP_TEST
    bool "net ipsec ipv4 tcp test component"
    depends on NET_IPSEC_TEST
    default n

config NET_IPSEC_IPV6_UDP_TEST
    bool "net ipsec ipv6 udp test component"
    depends on NET_IPSEC_TEST
    default n

config NET_IPSEC_IPV6_TCP_TEST
    bool "net ipsec ipv6 tcp test component"
    depends on NET_IPSEC_TEST
    default n

endmenu # Network Kernel Configurations

menu "Network Addons Configurations"

config NET_ADDONS
    bool "net addons component"
    depends on NET_COMMON
    default n

config NX_DNS
    bool "The DNS Client protocol(DNS)"
    depends on NET_ADDONS
    default n

config NX_BSD
    bool "Supports some of the basic BSD Socket API calls(BSD)"
    depends on NET_ADDONS
    default n

config PDP_MGR
    bool "PDP Manager"
    depends on NET_ADDONS && AT_PROC
    select NET_DRIVER
    select NET_ALTE_DRIVER
    default n

config NX_DHCP
    bool "Dynamic Host Configuration Protocol(DHCP and DHCPv6)"
    depends on NET_ADDONS
    default n

config NX_NAT
    bool "Network Address Translation(NAT)"
    depends on NET_ADDONS
    default n

config NET_PING
    bool "Supports aic network ping"
    depends on PLAT_CONSOLE && NET_ADDONS
    select NX_BSD
    default n

config NET_IFCONFIG
    bool "Supports aic network ifconfig"
    depends on PLAT_CONSOLE && NET_ADDONS
    default n

config IMS_NET_MGR
    bool "IMS Network Manager"
    depends on NET_ADDONS && NX_BSD
    select NET_CRYPTO_LITE_LIBRARIES
    select NET_IPSEC
    select NET_DRIVER
    select NET_IMS_NIC
    default n

endmenu # Network Addons Configurations

menu "Network Crypto And Secure Configurations"

config NET_CRYPTO_LIBRARIES
    bool "net crypto libraries component"
    depends on AZURE_NETXDUO
    default n

config NET_CRYPTO_LITE_LIBRARIES
    bool "net crypto lite libraries component, include md5/sha1/aes/3des"
    depends on AZURE_NETXDUO
    default n

config NET_SECURE
    bool "net secure component"
    depends on AZURE_NETXDUO
    default n

endmenu # Network Crypto And Secure Configurations

menu "Network Unility Configurations"

config NET_UTILITY
    bool "net utility(iperf...)"
    depends on AZURE_NETXDUO
    default n

config NET_IPERF
    bool "net iperf utility"
    depends on NET_UTILITY
    default n

endmenu # Network Unility Configurations

menu "Network Test Configurations"

config NET_TEST
    bool "net test component"
    depends on AZURE_NETXDUO
    default n

config NET_EXTERNEL_API_TEST
    bool "net externel api component test"
    depends on NET_TEST && NET_EXTERNEL_API
    default n

config NET_AIC_PACKET_TEST
    bool "aic packet management test"
    depends on NET_TEST && NET_NEW_PACKET_MANAGE
    default n

config NETXDUO_NAT_TEST
    bool "netxduo nat test"
    depends on NX_NAT && NET_TEST
    default n

config NET_HTTP_DEMO
    bool "http demo"
    depends on NET_HTTP && NET_TEST
    default n

endmenu # Network Test Configurations

endmenu # Network Basic Configurations

menu "CTCPIP extended configuration"
config CTCPIP_CLOSE_SOCKET_MANUALLY
    bool "Close socket manually"
    depends on CUSTOMER_AT
    default n
    help
        Enable it in order to keep socket open until right +CIPCLOSE AT cmd is set, otherwise the socket will be closed once it was dropped passively.

config CTCPIP_LOCAL_TEST_SERVER
    bool "Enable local test for UDP Server"
    depends on CUSTOMER_AT
    default n
    help
        Test purpose only. Enable it in order to test UDP server within local network.
endmenu # CTCPIP extended configuration

endmenu # Network Configurations
```

## aicos/components/nvram/Kconfig
```kconfig
menu "NVRAM Config"
    config NVRAM_SUPPORT
        bool "Enable nvram"
        default n
        help
          Enable nvram feature.

if SUBSYS_CP
    config NVRAM_SYNC_SUPPORT
        bool "Enable nvram cp sync data to ap."
        depends on NVRAM_SUPPORT
        default n
        help
          Enable nvram cp sync data to ap feature.

    config NVRAM_CALIBRATION_RECOVERY
        bool "Enable calibration data recovery"
        depends on NVRAM_SUPPORT
        default n
        help
          After download new nvram binary, calibration data recovery
          from download nvram, use for temp version.

    config NVRAM_TEST_SUPPORT
        bool "Enable nvram test feature"
        depends on NVRAM_SUPPORT
        default n
        help
          Enable nvram test feature.

    choice
        prompt "nvram hw diff selection"
        depends on NVRAM_SUPPORT
        default NVRAM_HW_DIFF_PAID

        config NVRAM_HW_DIFF_PAID
            bool "nvram hw diff select by pa id."
            help
                nvram hw diff select by pa id.

        config NVRAM_HW_DIFF_BOARDID
            bool "nvram hw diff select by board id."
            help
                nvram hw diff select by board id.
    endchoice
endif

if SUBSYS_AP
    config NVRAM_WTRD_COMPARE
        bool "Enable data write and read back compare"
        depends on NVRAM_SUPPORT
        default n
        help
          After nvram data write to flash, read back data to compare it.
endif

endmenu
```

## aicos/components/prodinfo/Kconfig
```kconfig
menu "PRODINFO Config"
    config RESET_ENTER_GXEM_SUPPORT
        bool "reset enter gxem"
        default n
        help
          Enable reset enter gxem.

    config UART_ENTER_GXEM
        bool "support uart enter gxem"
        default n
        help
          Enable support uart enter gxem.

if  UART_ENTER_GXEM
    config POWERON_DELAY_SLEEP_TIME
        int "the num of delay time(s) enter to sleep when power on"
        default 5
        help
            The num of delay time(s) enter to sleep when power on.

endif

endmenu
```

## aicos/components/secure/Kconfig
```kconfig
menu "security"
	config SECURE
	    bool "Support secure"
        default n
        help
          Support secure.
    config SECURE_BOOT
        bool "Support secure boot"
        default n
        help
          Support secure boot.
	config SECURE_BOOT_CORE
        bool "Support secure boot core"
        default n
        help
          Enable secure boot core
endmenu
```

## aicos/components/subsys_ctrl/Kconfig
```kconfig
menu "Subsys Config"
    config SUBSYS_CTRL_SUPPORT
        bool "Enable subsys control module"
        depends on DRIVER_SUBSYS_CTRL
        default y
        help
          Enable subsys control module to boot subsys.

    config SUPPORT_ADSP
        bool "Support adsp"
        default n
        select ADSP_AIPC
        help
          Support adsp in chip.

    config COMPRESS_EXTEND_AP
        bool "Enable compress extend ap image"
        default n
        help
          Compress extend ap image.

    config MEMMOVE_BASE_REGION_IMG
        bool "Enable memmove the image on the base region."
        default n
        help
          Memmove the image on the base region.
endmenu
```

## aicos/components/tele/Kconfig
```kconfig
# General configuration options
#
# Copyright 2022 by AICXTEK TECHNOLOGIES CO.,LTD. All rights reserved.

menu "Tele Config"

if !BYPASS_MD_AT
if TELE_SERVICE
config TELE_SERVICE_ENABLE
    bool "Enable Tele Service"
    depends on SUBSYS_AP
    default n
    help
        Enable Tele Service
endif
endif

if VOICE_CALL
config VOICE_SERVICE_ENABLE
    bool "Enable Voice Service"
    depends on SUBSYS_AP
    default n
    help
        Enable Voice Service
endif

config BYPASS_MD_AT
    bool "Support Bypass MD AT"
    depends on SUBSYS_AP && CMUX
    default n
    help
        Support Bypass MD AT


config VOICE_CALL
    bool "Voice Call"
    default n
    depends on AT_PROC
    depends on AUDIO_SUPPORT
    help
        Enable voice call

choice
    bool "Tele Control Config"
    depends on SUBSYS_AP
    default TELE_CTRL_BY_AT
    help
        select controller of modem init flow and URC process.

    config TELE_CTRL_BY_AT
        bool "Controlled by AT"
        help
            select AT control modem init flow and URC process

    config TELE_CTRL_BY_CUSTOMER
        bool "Controlled by Customer" #        depends on TELE_SERVICE
        help
            select customer control modem init flow and URC process
endchoice


config TELE_SERVICE_EX
    bool "Tele Service Ex (Based on AT Cmd Support)"
    depends on SUBSYS_AP
    default n
    help
      Enable config for tele service which based on AT cmd, not depends on modem driver

if !BYPASS_MD_AT

menu "Enable Tele Sub-modules"

    config TELE_RADIO_SIM
        bool "Tele Radio and SIM"
        default n
        help
          Enable config for Radio and SIM which are the base modules of tele service

    config TELE_CALL
        bool "Tele Call"
        default n
        help
          Enable config for tele call which based on tele service

    config TELE_DATA
        bool "Tele Data"
        default n
        help
          Enable config for tele data which based on tele service

    config TELE_SMS
        bool "Tele SMS"
        select TELE_TRANSACTION
        default n
        help
          Enable config for tele sms which based on tele service

    config TELE_PB
        bool "Tele PB"
        default n
        help
          Enable config for tele pb which based on tele service

endmenu #menu "Enable TELE Sub-modules"


source "components/tele/modem_driver/Kconfig"
source "components/tele/service/Kconfig"

endif

endmenu
```

## aicos/components/tele/modem_driver/Kconfig
```kconfig
# General configuration options
#
# Copyright 2023 by AICXTEK TECHNOLOGIES CO.,LTD. All rights reserved.

config MODEM_DRIVER
    bool "Modem Driver Support" #    depends on SUPPORT_MD_IODEV
    default n
    help
      Enable config for modem driver.
choice
    bool "Choice MD I/O Device Type"
    depends on MODEM_DRIVER
    default MD_IODEV_AIC_AT
    help
        select which type for ModemDriver I/O Device.

    config MD_IODEV_AIC_AT
        bool "Support MD I/O Device by AIC_AT"
        help
            Support ModemDriver I/O Device by AIC_AT

    config MD_IODEV_AIC_CMUX
        bool "Support MD I/O Device by AIC_CMUX"
        help
            Support ModemDriver I/O Device by AIC_CMUX

endchoice


choice
    bool "Choice Modem Driver Adapter"
    depends on MODEM_DRIVER
    default ADAP_RTOS
    help
        select which modem driver adapter.

    config ADAP_RTOS
        bool "Run RTOS Adapter"
        help
            Modem driver rtos adapter

    config ADAP_LINUX
        bool "Run Linux adapter, NOT support yet"
        help
            Modem driver Linux adapter

endchoice
```

## aicos/components/tele/service/Kconfig
```kconfig
# General configuration options
#
# Copyright 2023 by AICXTEK TECHNOLOGIES CO.,LTD. All rights reserved.

menuconfig TELE_SERVICE

    bool "Tele Service (Based on Modem Driver Support)"
    depends on SUBSYS_AP
    depends on MODEM_DRIVER
    default n
    help
      Enable config for tele service which based on modem driver


if TELE_SERVICE

    config TELE_SERVICE_TRANSACTION
        bool "Tele Service TRANSACTION"
        depends on TELE_SERVICE
        default n
        help
          Enable config for tele service transaction which based on tele service

endif #if TELE_SERVICE
```
