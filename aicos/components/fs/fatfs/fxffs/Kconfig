## aicos/components/fs/fatfs/fxffs/Kconfig
```kconfig
# General configuration options
#
# Copyright 2021 by AICXTEK TECHNOLOGIES CO.,LTD. All rights reserved.
#

menuconfig AZURE_FILEX
    tristate "Azure FILEX support"
    default y
    help
        filex provides fat12/16/32 format for file system..

if AZURE_FILEX
    config FX_ENABLE_FAULT_TOLERANT
        default y
        tristate "filex fault tolerant enable"
        depends on AZURE_FILEX
        help
            Enable filex fault tolerant

    config FX_ENABLE_EXFAT
        tristate "filex exfat format enable"
        depends on AZURE_FILEX
        help
            Enable filex exfat format

    config FX_UTF8_SUPPORT
        bool "Support utf-8 file/directory name as input."
        default y
        depends on AZURE_FILEX
        help
            Enable FileX UTF8 support
endif
```

## aicos/components/fs/littlefs/Kconfig
```kconfig
menuconfig FS_LITTLEFS
    tristate "LittleFS File System support"
    default n
    help
        This option will provide the lfs support for users to transparently access the
        file system.

if FS_LITTLEFS
    config FS_LITTLEFS_BLOCK_SIZE
        int "Size of block in bytes"
        default 4096
        help
            Size of block in bytes.

    config FS_LITTLEFS_RW_SIZE
        int "Size of read or prog in bytes"
        default 256
        help
            Size of read or prog in bytes.

    config FS_LITTLEFS_LOOKAHEAD_SIZE
        int "Size of lookahead buffer in bytes"
        default 32
        help
            Size of lookahead buffer in bytes, the size must be a multiple of 8.

    config FS_LITTLEFS_BLOCK_CYCLES
        int "Number of erase cycles before moving data to another block"
        default 512
        help
            Number of erase cycles before moving data to another block

    config FS_LFS_IMAGE_GEN
        bool "Generate LFS image at build time"
        default n
        help
            Generate LFS image at build time.

    config FS_LFS_IMAGE_GEN_SIZE
        int "Size of gernerated lfs image"
        default 65536
        depends on FS_LFS_IMAGE_GEN
        help
            Size of the LFS image in bytes.
endif
```

## aicos/components/fs/test/Kconfig
```kconfig
# General configuration options
#
# Copyright 2021 by AICXTEK TECHNOLOGIES CO.,LTD. All rights reserved.
#

menu "File System Test Select"
    config FS_TEST
        tristate "fs api test"
        help
            test file system.

    config FS_LIBC_TEST
        tristate "fs libc api test"
        help
            test file system libc interface.
endmenu
```

## aicos/components/gps/Kconfig
```kconfig
menu "GPS"
    config GPS
        bool "Support GPS"
        default n
        help
          Support GPS.
    config ICOE_GPS
        bool "Support ICOE GPS"
        depends on GPS
        default n
        help
          Support ICOE GPS.
    config ICOE_GPS_FW
        bool "Produce ICOE GPS FW binary"
        depends on ICOE_GPS
        default n
        help
          Produce ICOE GPS FW binary.
    config ICOE_GPS_SRC
        bool "Add ICOE GPS driver"
        depends on ICOE_GPS
        default n
        help
          Add ICOE GPS driver.
endmenu
```

## aicos/components/graphics/Kconfig
```kconfig
# General configuration options
#
# Copyright 2022 by AICXTEK TECHNOLOGIES CO.,LTD. All rights reserved.

menuconfig GRAPHICS
    bool "Graphics Options"
    depends on SUBSYS_AP
    default n
    help
      Enable config options for graphics Configurations.

if GRAPHICS

source "components/graphics/lvgl/Kconfig"
source "components/graphics/alv/Kconfig"

endif #graphics Configurations
```

## aicos/components/iconv/Kconfig
```kconfig
# General configuration options
#
# Copyright 2021 by AICXTEK TECHNOLOGIES CO.,LTD. All rights reserved.

menu "ICONV Config"
    config USE_ICONV
        bool "Use iconv"
        default y
        help
        Enable to use code page converters, e.g. GBK to Unicode

    if USE_ICONV
        config ICONV_UTF8
            bool "converter between UTF8 and Unicode"
            default y
            help
                enable to use converter between UTF8 and Unicode

        config ICONV_GB2312
            bool "converter between GB2312 and Unicode"
            default n
            help
                enable to use converter between GB2312 and Unicode

        config ICONV_GBK
            bool "converter between GBK and Unicode"
            default n
            help
            enable to use converter between GBK and Unicode
  endif
endmenu
```

## aicos/components/init/Kconfig
```kconfig
menu "Init Config"
    config PLAT_AUTO_INIT
        bool "Auto init Enable"
        default y
        help
          Enable the auto init function.

    config PLAT_CMDLINE
        bool "Command Line Enable"
        default y
        help
          Enable the command line function.

    config PLAT_THREADX_SAMPLE
        bool "Threax sample Enable"
        default n
        help
          Enable the sample threadx.
endmenu
```

## aicos/components/location/Kconfig
```kconfig
# General configuration options
#
# Copyright 2023 by AICXTEK TECHNOLOGIES CO.,LTD. All rights reserved.

menu "Location Config"

config LOCATION
    bool "Location Support"
    depends on SUBSYS_AP
    depends on TELE_SERVICE_EX
    default n
    help
      Enable config for location.

choice
    bool "Choice Location Server"
    depends on LOCATION
    default SERVER_ONE_OS
    help
        select which location server used.

    config SERVER_ONE_OS
        bool "Use OneOS Location Server"
        help
            Use OneOS Location Server.

endchoice

endmenu
```

## aicos/components/mcx/Kconfig
```kconfig
# General configuration options
#
# Copyright 2021 by AICXTEK TECHNOLOGIES CO.,LTD. All rights reserved.
#

#
# Support AP&CP MCX on flash.
#

menu "MCX Configure"
    config MCX_SUPPORT
        bool "MCX support"
        default n
        help
          Enable AP&CP MCX on flash.

    config MCX_DEBUG
        bool "MCX debug"
        default n
        help
          Enable AP&CP MCX debug.

    config MCX_TEST
        bool "MCX test"
        default n
        help
          Enable MCX test.
endmenu
```

## aicos/components/misc/Kconfig
```kconfig
menu "MISC Config"
    config MISC_SUPPORT
        bool "Enable misc"
        default n
        help
          Enable misc feature.

    config MISC_TEST_SUPPORT
        bool "Enable misc test feature"
        depends on MISC_SUPPORT
        default n
        help
          Enable misc test feature.
endmenu
```

## aicos/components/network/Kconfig
```kconfig
# General configuration options
#
# Copyright 2023 by AICXTEK TECHNOLOGIES CO.,LTD. All rights reserved.

menu "Network Configurations"

choice
prompt "Select tcpip stack"
default USE_NETXDUO

config USE_NETXDUO
    bool "use netxduo 6.1.9"

config USE_LWIP
    bool "use lwip 2.1.3"
    depends on SUBSYS_CP

endchoice

if SUBSYS_CP
source "components/network/lwip/Kconfig"
endif

source "components/network/netxduo/Kconfig"
source "components/network/net_extension/Kconfig"

endmenu # Network Configurations
```

## aicos/components/network/lwip/Kconfig
```kconfig
# General configuration options
#
# Copyright 2023 by AICXTEK TECHNOLOGIES CO.,LTD. All rights reserved.

menu "Lwip Configurations"

config TCPIP_LWIP
    bool "support tcpip lwip library"
    depends on USE_LWIP
    default n

menu "Lwip Socket test Configurations"
config TCPIP_LWIP_TEST
    bool "support tcpip lwip test"
    depends on TCPIP_LWIP
    default n

config TCPIP_LWIP_TEST_TCP
    bool "support tcpip lwip tcp test"
    depends on TCPIP_LWIP_TEST
    default n

config TCPIP_LWIP_TEST_UDP
    bool "support tcpip lwip udp test"
    depends on TCPIP_LWIP_TEST
    default n

config TCPIP_LWIP_TEST_UDP6
    bool "support tcpip lwip udp6 test"
    depends on TCPIP_LWIP_TEST
    default n

config TCPIP_LWIP_IPSEC_TEST_TCP
    bool "support tcpip lwip ipsec tcp test"
    depends on TCPIP_LWIP_TEST
    default n

config TCPIP_LWIP_IPSEC_TEST_UDP
    bool "support tcpip lwip ipsec udp test"
    depends on TCPIP_LWIP_TEST
    default n

config TCPIP_LWIP_IPSEC_TEST_TCP6
    bool "support tcpip lwip ipsec tcp6 test"
    depends on TCPIP_LWIP_TEST
    default n

config TCPIP_LWIP_IPSEC_TEST_UDP6
    bool "support tcpip lwip ipsec udp6 test"
    depends on TCPIP_LWIP_TEST
    default n

endmenu # Lwip Socket Test Configurations

endmenu # Lwip Configurations
```

## aicos/components/network/net_extension/Kconfig
```kconfig
# General configuration options
#
# Copyright 2021 by AICXTEK TECHNOLOGIES CO.,LTD. All rights reserved.

menu "Network Extension"

config NET_EXT
    bool "Network Extended Function"
    depends on USE_LWIP || USE_NETXDUO
    default n

config SOCK_CB_MGR
    bool "Socket Callback Manager"
    depends on NET_EXT
    default n

config MOBILE_DM
    bool "Supports Mobile Terminal Management"
    depends on NET_EXT
    depends on CRYPTO_MBEDTLS
    default n

endmenu # Network Extension
```
