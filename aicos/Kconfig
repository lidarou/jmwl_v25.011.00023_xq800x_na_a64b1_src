## aicos/Kconfig
```kconfig
# General configuration options
#
# Copyright (c) 2021 AIC Inc.

mainmenu "AIC Software Menuconfig"

menu "Build Env Options"
    config OS_SYSTEM
        string "The Software System"
        default "azure-rtos"
        help
          Select the sw system, it could be azure-rtos, freertos e.g.

    config RTOS_OS_NAME
        string "The rtos os name"
        default "threadx"
        help
          Config rtos os name.

    choice
        prompt "Compiler selection"
        help
          This menu uses to select the compiler aicos used.
          It includes gcc/ac5/ac6 compilers.

        config COMPILER_GCC
            bool "Compiler GCC"
            help
              Compiler is GCC.

        config COMPILER_AC5
            bool "Compiler ARM AC5"
            help
              Compiler is ARM AC5.

        config COMPILER_AC6
            bool "Compiler ARM AC6"
            help
              Compiler is ARM AC6.
    endchoice

    config TOOLCHAIN_VARIANT
        string
        default "gnuarmemb" if COMPILER_GCC
        default "llvm" if COMPILER_AC5 || COMPILER_AC6
        help
          Select toolchain as the compiler.

    config COMPILER_NAME
        string
        default "gnu" if COMPILER_GCC
        default "ac5" if COMPILER_AC5
        default "ac6" if COMPILER_AC6
        help
          Set the compiler name, it will be used to
          select different compiler config or source files.

    choice
        prompt "Optimization level"
        default NO_OPTIMIZATIONS    if COVERAGE
        default DEBUG_OPTIMIZATIONS if DEBUG
        default SIZE_OPTIMIZATIONS
        help
          Note that these flags shall only control the compiler
          optimization level, and that no extra debug code shall be
          conditionally compiled based on them.

        config FAST_OPTIMIZATIONS
            bool "Optimize for fast"
            help
              Compiler optimizations will be set to -Ofast independently of other
              options.

        config SIZE_OPTIMIZATIONS
            bool "Optimize for size"
            help
              Compiler optimizations will be set to -Os independently of other
              options.

        config SPEED_OPTIMIZATIONS
            bool "Optimize for speed"
            help
              Compiler optimizations will be set to -O2 independently of other
              options.

        config DEBUG_OPTIMIZATIONS
            bool "Optimize debugging experience"
            help
              Compiler optimizations will be set to -Og independently of other
              options.

        config NO_OPTIMIZATIONS
            bool "Optimize nothing"
            help
              Compiler optimizations will be set to -O0 independently of other
              options.

    endchoice

    menu "Compiler Options"

        config COMPILER_COLOR_DIAGNOSTICS
                bool "Enable colored diganostics"
                default y
                help
                  Compiler diagnostic messages are colorized.

    endmenu # Compiler Options

    menu "Linker Options"

        config LINKER_SORT_BY_ALIGNMENT
                bool "Sort input sections by alignment"
                default y
                help
                  This turns on the linker flag to sort sections by alignment
                  in decreasing size of symbols. This helps to minimize
                  padding between symbols.

        config LINKER_USE_LIBC
            bool "linker use libc"
            depends on COMPILER_GCC
            default n
            help
              if it is true, link wtih libc, else link with libc_nano.

        config LINKER_PRINT_FLOAT
            bool "linker with printf float option."
            depends on COMPILER_GCC
            default n
            help
              if it is true, link wtih printf float option.

        config MULTI_BIN_SUPPORT
            bool "Multiple binary support"
            depends on COMPILER_GCC
            help
              Generate multiple binary files from elf, only used with GCC.

        config SUPPORT_4_PSRAM_BIN
            bool "support 4 psram binary"
            default n
            depends on SUBSYS_CP
            help
              Generate 4 psram binary files.

        config SUPPORT_6_PSRAM_BIN
            bool "support 6 psram binary"
            default n
            depends on SUPPORT_4_PSRAM_BIN
            help
              Generate 6 psram binary files.

        choice
            prompt "Linker Orphan Section Handling"
            default LINKER_ORPHAN_SECTION_PLACE

            config LINKER_ORPHAN_SECTION_PLACE
                bool "Place"
                help
                  Linker puts orphan sections in place without warnings
                  or errors.

            config LINKER_ORPHAN_SECTION_WARN
                bool "Warn"
                help
                  Linker places the orphan sections in output and issues
                  warning about those sections.

            config LINKER_ORPHAN_SECTION_ERROR
                bool "Error"
                help
                  Linker exits with error when an orphan section is found.

        endchoice
    endmenu # Linker Options

endmenu # Build Env Options

# AIC SoC chip options
menu "Chip Options"
    # AIC SoC subsystem select configurations
    choice
        prompt "AIC SoC SubSYS Selection"

        config SUBSYS_AP
            bool "Select AP subsys"
            help
              SoC includes mult subsys, this select ap subsys.

        config SUBSYS_AP_ONLY
            bool "AP subsys only"
            depends on SUBSYS_AP
            default n
            help
              This config ap subsys only, it mean no other subsys co-work with ap.

        config SUBSYS_CP
            bool "Select CP subsys"
            help
              SoC includes mult subsys, this select cp subsys.

        config SUBSYS_CP_ONLY
            bool "CP subsys only"
            depends on SUBSYS_CP
            default n
            help
              This config cp subsys only, it mean no other subsys co-work with cp.
    endchoice

    # AIC SoC PMIC Selection configurations
    menuconfig PMIC
        bool "PMIC Chips Select"
        select PMIC_I2C
        select PMIC_I2C_DRIVER
        help
          Enable config options for PMIC Chips.

    if PMIC
        choice
            prompt "AIC SoC PMIC Selection"
            default PMIC_GP201

            config PMIC_GP201
                bool "PMIC GP201"
                help
                    select pmic gp201 for aicos.

            config PMIC_GP202
                bool "PMIC GP202"
                help
                    select pmic gp202 for aicos.

            config PMIC_GP301
                bool "PMIC GP301"
                help
                    select pmic gp301 for aicos.
        endchoice

        if PMIC_GP201
            config PMIC_VERSION
                string
                default "gp201"
        endif

        if PMIC_GP202
            config PMIC_VERSION
                string
                default "gp202"
        endif

        if PMIC_GP301
            config PMIC_VERSION
                string
                default "gp301"
        endif
    endif

    # AIC chip fimaly configuration
    config AIC_CHIP_GENESIS
        bool "Select GENESIS chip"
        select CPU_ARCH_ARM
        select CPU_CORTEX_MSTAR if SUBSYS_AP
        select CPU_CORTEX_R5 if SUBSYS_CP
        select COMPILER_ISA_THUMB2
        help
          Select GENESIS chip.

    #AIC chip FPGA options
    config CHIP_FPGA
        bool "Chip FPGA Options"
        default n
        help
          If chip in FPGA stage, should define
          this configuration.
endmenu # Board Options

# AIC Release options
menu "Release Options"

    config CP_OPEN_SOURCE
        bool "Set CP code as open source"
        depends on SUBSYS_CP
        default n
        help
          If yes means that CP code will be set as open source.

    config SDK_ENABLE
        bool "Platform SDK Enable"
        depends on SUBSYS_AP || CP_OPEN_SOURCE
        default n
        help
          This configuration used to compile platform SDK code.

    config CONSUMER_SDK
        bool "Consumer SDK Enable"
        depends on SUBSYS_AP
        default n
        help
          This configuration used to compile consumer SDK code.

endmenu # Release Options

# AIC Product options
menu "Product Options"
    config LOW_THROUGHPUT
        bool "Low Throughput Enable"
        default n
        help
          This configuration used to enable Low Throughput Feature.
endmenu # Product Options

source "drivers/Kconfig"
source "components/Kconfig"
if RTOS_THREADX
osource "os/kernel/threadx/utility/rtos_compatibility_layers/Kconfig"
endif
if RTOS_LITEOS_M
osource "os/kernel/liteos_m/Kconfig"
endif
source "os/osa/Kconfig"
source "mm/Kconfig"
source "app/Kconfig"
source "vendors/Kconfig"

if SUBSYS_CP && !SDK_ENABLE
osource "comm/ims/Kconfig"
osource "comm/ps/Kconfig"
osource "comm/phy/Kconfig"
endif
```

## aicos/app/lvgl_demo_apps/Kconfig
```kconfig
# General configuration options
#
# Copyright 2021 by AICXTEK TECHNOLOGIES CO.,LTD. All rights reserved.

choice
    bool "lvgl demo app" if APP_ENTRY_LVGL_DEMO
    depends on LV_CONF_MINIMAL
    default LV_USE_DEMO_BENCHMARK
    help
      select which demo app should be added.
      Depends on LV_CONF_MINIMAL at "Components Options → Graphics Options → LVGL configuration"

    config LV_USE_DEMO_STRESS
        bool "stress test app"
    config LV_USE_DEMO_BENCHMARK
        bool "benchmark app"
    config LV_USE_DEMO_KEYPAD_AND_ENCODER
        bool "keypad and encoder demo app"
    config LV_USE_DEMO_MUSIC
        bool "music demo app"
    config LV_USE_DEMO_WIDGETS
        bool "widgets demo app"
endchoice
```

## aicos/app/samples/Kconfig
```kconfig
# General configuration options
#
# Copyright 2023 by AICXTEK TECHNOLOGIES CO.,LTD. All rights reserved.

menu "Sample codes"
    depends on APP

    config I2C_SAMPLE
        bool "I2C sample"
        help
           Select i2c sample.

    config UART_SAMPLE
        bool "UART sample"
        help
           Select uart sample.

    config POWER_SUPPLY_SAMPLE
        bool "power supply sample"
        select POWER_SUPPLY
        select POWER_SUPPLY_CORE
        help
           Select power supply sample.

    config BACKLIGHT_SAMPLE
        bool "backlight operate sample code"
        depends on DRIVER_BACKLIGHT
        default n
        help
            lcd panel backlight user demo.

    config SMS_SAMPLE
        bool "sms sample"
        default n
        help
           Select sms sample.

    config RADIO_CFUN_SAMPLE
        bool "radio cfun sample"
        default n
        help
           Select radio cfun sample.

    config WIFISCAN_SAMPLE
        bool "wifi scan sample"
        help
           Select wifi scan sample.

    config APP_AUDIO_MP3_SAMPLE
        bool "app audio mp3 sample"
        help
           Select app audio mp3 sample.

    config WAKEUP_SAMPLE
        bool "wakeup sample"
        default n
        help
           Select wakeup sample.

    config SSP_SAMPLE
        bool "ssp sample"
        default n
        help
           Select ssp sample.

    config AUTO_REG_IMS_SAMPLE
        bool "auto reg ims sample"
        default n
        help
           Select auto reg ims sample.

menu "Network sample"
    config NET_SOCKET_IPV4_UDP_TEST
        bool "ipv4 udp socket test"
        depends on NX_BSD
        help
          Select NX_BSD.

    config NET_SOCKET_IPV4_RAW_TEST
        bool "ipv4 raw socket test"
        depends on NX_BSD
        help
          Select NX_BSD.

    config NET_SOCKET_IPV4_TCP_TEST
        bool "ipv4 tcp socket test"
        depends on NX_BSD
        help
          Select NX_BSD.

    config NET_SOCKET_IPV6_UDP_TEST
        bool "ipv6 udp socket test"
        depends on NX_BSD
        help
          Select NX_BSD.

    config NET_SOCKET_IPV6_TCP_TEST
        bool "ipv6 tcp socket test"
        depends on NX_BSD
        help
          Select NX_BSD.

    config NET_SOCKET_IPV6_RAW_TEST
        bool "ipv6 raw socket test"
        depends on NX_BSD
        help
          Select NX_BSD.

    config NET_SOCKET_DEMO_TEST
        bool "socket demo test"
        depends on NX_BSD
        help
          Select NX_BSD.
endmenu

menu "Telephony sample"
    config TELE_RADIO_SAMPLE
        bool "Tele radio sample"
        help
          Select Tele radio sample.

    config TELE_SIM_SAMPLE
        bool "Tele SIM sample"
        help
          Select Tele SIM sample.

    config TELE_DATA_SAMPLE
        bool "Tele data sample"
        help
          Select Tele data sample.

    config TELE_CALL_SAMPLE
        bool "Tele call sample"
        help
          Select Tele call sample.

    config TELE_SMS_SAMPLE
        bool "Tele SMS sample"
        help
          Select Tele SMS sample.

    config TELE_SMS_EX_SAMPLE
        bool "Tele SMS EX sample"
        help
          Select Tele SMS EX sample.

    config TELE_PB_SAMPLE
        bool "Tele phonebook sample"
        default n
        help
            Select Tele phonebook sample.

endmenu

endmenu
```

## aicos/components/Kconfig
```kconfig
menu "Components Options"

source "components/aipc/Kconfig"
source "components/alog/Kconfig"
source "components/almsg/Kconfig"
source "components/assert/Kconfig"
source "components/at/Kconfig"
source "components/benchmark/Kconfig"
source "components/console/Kconfig"
source "components/connmgr/Kconfig"
source "components/crypto/Kconfig"
source "components/diag/Kconfig"
source "components/blt/Kconfig"
if SUBSYS_AP
source "components/fota/Kconfig"
endif
source "components/fs/Kconfig"
source "components/graphics/Kconfig"
source "components/gps/Kconfig"
source "components/init/Kconfig"
source "components/mcx/Kconfig"
source "components/misc/Kconfig"
source "components/network/Kconfig"
source "components/nvram/Kconfig"
source "components/secure/Kconfig"
source "components/subsys_ctrl/Kconfig"
source "components/aic_ctrl/Kconfig"
source "components/tele/Kconfig"
source "components/usb/Kconfig"
source "components/wifi/Kconfig"
source "components/tmr/Kconfig"
if SUBSYS_AP
source "components/location/Kconfig"
source "components/iconv/Kconfig"
source "components/prodinfo/Kconfig"
source "components/d2d_mgr/Kconfig"
source "components/d2d/Kconfig"
osource "components/d2d_app/Kconfig"
endif

endmenu
```

## aicos/components/aic_ctrl/Kconfig
```kconfig
menu "aic ctrl Config"
    config AIC_CTRL_SUPPORT
        bool "Enable aic control module"
        depends on CMUX
        default n
        help
          Enable aic control module.

    config AIC_CTRL_D2D
        bool "Enable aic control on d2d"
        depends on AIC_CTRL_SUPPORT
        default n
        help
          Enable aic control module.

    config AIC_CTR_DBG_ON_CMUX
        bool "Enable aic control dbg on cmux"
        depends on AIC_CTRL_SUPPORT
        default n
        help
          Enable it will pass the dbg data by cmux.
endmenu
```

## aicos/components/aipc/Kconfig
```kconfig
menu "Aipc Config"
    config AIPC_SUPPORT
        bool "Enable aipc feature"
        default y
        help
          Enable aipc feature. Contain amsg protocol and ablk protocol.

    config AIPC_ABUF_SUPPORT
        bool "Enalbe abuf protocol"
        depends on AIPC_SUPPORT
        default y
        help
          Enalbe the abuf protocol for buffer data transmission.

    config AIPC_CUSTOMER_CFG
        bool "Enalbe aipc coustomer config"
        depends on AIPC_SUPPORT
        default n
        help
          Enalbe aipc coustomer config.

    config ADSP_AIPC
        bool "Enable adsp aipc."
        depends on AIPC_SUPPORT
        default n
        help
          Enable adsp aipc.
endmenu
```
