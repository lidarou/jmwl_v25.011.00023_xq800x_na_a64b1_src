## aicos/components/almsg/Kconfig
```kconfig
menu "Almsg Config"
    config ALOG_MSG_SUPPORT
        bool "Enable alog message feature"
        depends on ALOG_SUPPORT
        default n
        help
          Enable alog message feature.

endmenu
```

## aicos/components/alog/Kconfig
```kconfig
menu "Alog Config"
    config ALOG_SUPPORT
        bool "Enable alog feature"
        default y
        help
          Enable alog feature.

    config ALOG_CUSTOMER_CFG
        bool "Enable alog customer config"
        depends on ALOG_SUPPORT
        default n
        help
          Enable alog customer config.

    config ALOG_STATIC_LEVEL
        int "Alog static level"
        depends on ALOG_SUPPORT
        default 3
        help
          Set the static log level, 0--none, 1--error,
          2--warn, 3--info, 4--debug,

    config ALOG_TRACE_IDX
        bool "Convert strings to ID"
        depends on ALOG_SUPPORT
        default y
        help
          Enable Convert strings to ID feature.

    config ALOG_FRAME_SUPPORT
        bool "Enable alog frame feature"
        depends on ALOG_SUPPORT
        default y
        help
         Enable alog frame feature.

    config ALOG_BITMAP_STRING
        bool "Enable alog bitmap string function."
        depends on ALOG_SUPPORT
        default n
        help
         Enable alog bitmap string function.

    config LOG_FILE_LINE
        bool "Enable alog record fileid and line number."
        depends on ALOG_TRACE_IDX
        default n
        help
         Enable alog record fileid and line number.

    config NET_PCAP_DUMP
        bool "network pcap dump"
        depends on ALOG_SUPPORT
        default n

    config ALOG_STORE_FS
        bool "Log save to file system."
        depends on FS
        default n

    config ALOG_STORE_ENABLE_COPY
        bool "Enable copy log to a buffer before save."
        depends on ALOG_STORE_FS
        default n

    config DBG_CPPC_SAMP
        bool "Enable CP PC sample fucntion."
        depends on ALOG_SUPPORT
        default n

endmenu
```

## aicos/components/at/Kconfig
```kconfig
menu "AT Config"
    config AT_PROC
        bool "AT process"
        default n

    config AT_WAKEUP_TARGET_MCU
        bool "AT Wakeup Target Mcu"
        depends on AT_PROC
        select DRIVER_GPIO_WAKEUP
        default n

    config AT_PROC_MINI
        bool "Mini AT Process"
        depends on AT_PROC
        default n

    config CUSTOMER_AT
        bool "Customer AT"
        select NET_AT
        select NET_SNTP
        default n

    config CUSTOMER_JQ_AT
        bool "Customer JQ AT"
        default n

    menuconfig NET_AT
        bool "Net AT"
        depends on AZURE_NETXDUO && NX_BSD
        default n

    if NET_AT
    choice
    prompt "Net AT selection"

    config GX_AT_V2
        bool "GX AT V2"
        if GX_AT_V2
        config GX_TCPIP_AT
            bool "GX TCPIP AT Command"
            select NET_SNTP
            default n

        config GX_SSL_AT
            bool "GX SSL AT Command"
            select CRYPTO_MBEDTLS
            default n

        config GX_HTTP_AT
            bool "GX HTTP AT"
            default n

            choice
                prompt "seletct HTTP AT type"
                depends on GX_HTTP_AT
                default GX_HTTP

                config GX_HTTP
                    bool "Only support HTTP AT"
                    select NET_HTTP

                config GX_HTTPS
                    bool "Support HTTP and HTTPS AT"
                    select CRYPTO_MBEDTLS
                    select NET_HTTPS
            endchoice

        config GX_MQTT_AT
            bool "GX MQTT AT"
            default n

            choice
                prompt "seletct MQTT AT type"
                depends on GX_MQTT_AT
                default GX_MQTT

                config GX_MQTT
                    bool "Only support MQTT AT"
                    select NET_MQTT

                config GX_MQTTS
                    bool "Support MQTT and MQTTS AT"
                    select CRYPTO_MBEDTLS
                    select NET_MQTTS
            endchoice

        config GX_USB_DIAL_AT
            bool "GX USB DIAL AT Command"
            depends on USB_NET_SHARE
            default n
        endif

    config CUSTOMER_CM_AT
        bool "Customer CM AT"
        if CUSTOMER_CM_AT
        config CM_TCPIP_AT
            bool "CM TCPIP AT Command"
            select NET_SNTP
            default n

        config CM_SSL_AT
            bool "CM SSL AT Command"
            select CRYPTO_MBEDTLS
            default n

        config CM_MQTT_AT
            bool "CM MQTT AT Command"
            select CRYPTO_MBEDTLS
            select NET_MQTTS
            select CM_SSL_AT
            default n

        config CM_HTTP_AT
            bool "CM HTTP AT Command"
            select CRYPTO_MBEDTLS
            select NET_HTTPS
            select CM_SSL_AT
            default n

        config CM_USB_DIAL_AT
            bool "CM USB DIAL AT Command"
            depends on USB_NET_SHARE
            default n

        config CM_LWM2M_AT
            bool "LWM2M AT"
            select NET_LWM2M
            default n
        endif

    config GX_AT_V1
        bool "GX AT V1"
    if GX_AT_V1
        config NET_AT_IPERF
            bool "Supports aic Iperf AT Command"
            default n

        config NET_AT_TCPIP
            bool "Supports TCPIP AT Command"
            default n

        config NET_AT_PING
            bool "Supports PING AT Command"
            select NET_AT_TCPIP
            default n

        config NET_AT_SNTP
            bool "Supports SNTP AT Command"
            select NET_SNTP
            select NET_AT_TCPIP
            default n

        config NET_AT_TCP
            bool "Supports TCP AT Command"
            select NET_AT_TCPIP
            default n

        config NET_AT_UDP
            bool "Supports UDP AT Command"
            select NET_AT_TCPIP
            default n

        config NET_AT_TLS
            bool "Supports TLS AT Command"
            select NET_AT_TCPIP
            default n

        config GX_USB_DIAL_AT
            bool "GX USB DIAL AT Command"
            depends on USB_NET_SHARE
            default y

        config NET_AT_TEST
            bool "AT Test Component"
            default n
    endif
    endchoice
    endif
endmenu
```

## aicos/components/benchmark/Kconfig
```kconfig
# General configuration options
#
# Copyright 2021 by AICXTEK TECHNOLOGIES CO.,LTD. All rights reserved.

menu "Benchmark Configurations"

config BENCHMARK
    bool "Run benchmark"
    default y

config BCMARK_DHRYSTONE 
    bool "Run dhrystone v2.1"
    depends on BENCHMARK
    help
      Run dhrystone for evaluation

endmenu # Benchmark Configurations
```

## aicos/components/blt/Kconfig
```kconfig
menu "BLT Config"
    config BLT_SUPPORT
        bool "Enable Board-Level Test"
        default n
        help
          Enable the Board-Level Test

endmenu
```

## aicos/components/connmgr/Kconfig
```kconfig
menu "Connmgr Config"
    config CONNECT_MGR
        bool "Enable Connect mananger"
        default n
        help
          Enable the connect manager module

    config AT_BYPASS_TO_CP
        depends on CONNECT_MGR
        bool "Enable bypass at to cp feature"
        default n
        help
          Enable the bypass at to cp feature

endmenu
```

## aicos/components/console/Kconfig
```kconfig
menu "Console Config"
    config PLAT_CONSOLE
        bool "Console Enable"
        default y
        help
          Enable the console function.

endmenu
```

## aicos/components/crypto/Kconfig
```kconfig
# General configuration options
#
# Copyright 2023 by AICXTEK TECHNOLOGIES CO.,LTD. All rights reserved.

menu "Crypto Component Configurations"

config CRYPTO_MBEDTLS
    bool "support mbedtls crypto library"
    default n

choice
    prompt "mbedtls version selection"
    depends on CRYPTO_MBEDTLS
    default CRYPTO_MBEDTLS_3

config CRYPTO_MBEDTLS_3
    bool "support mbedtls-3.3.0 crypto library"

config CRYPTO_MBEDTLS_2
    bool "support mbedtls-2.1.8 crypto library"

endchoice

endmenu # Crypto Configurations
```

## aicos/components/d2d/Kconfig
```kconfig
menu "D2D Config"
    config D2D_SWITCH
    bool "Enable D2D feature"
    default n
    help
      Enable D2D feature.

    choice
    prompt "L3 selection"
    depends on D2D_SWITCH
    help
      This menu uses to select the profile for D2D L3.

    config D2D_L3
        bool "D2D L3 real"
        help
          Use D2D L3 real.

    config D2D_L3_DUMMY
        bool "D2D L3 dummy"
        help
          Use D2D L3 dummy.
    endchoice

endmenu
```

## aicos/components/d2d_app/Kconfig
```kconfig
menu "D2D App Module"
    config D2D_APP
        bool "d2d app"
        depends on D2D
        default n
        help
          Enable d2d app module.
    choice
    prompt "codec select"
    default D2D_CODEC_ISELP
    depends on D2D_APP
    help
        select codec type

    config D2D_CODEC_ISELP
        bool "iselp codec"
        help
            iselp codec

    config D2D_CODEC_PRIVOICE
        bool "privoice codec"
        help
            privoice codec
    endchoice
endmenu
```

## aicos/components/d2d_mgr/Kconfig
```kconfig
menu "D2D Management Module"
    config D2D
        bool "d2d module"
        depends on NX_BSD
        default n
        help
          Enable d2d management module.

endmenu
```

## aicos/components/diag/Kconfig
```kconfig
menu "Diag Config"
    config DIAG_SUPPORT
        bool "Enable Diag module"
        default y
        help
          Enable the diag module

endmenu
```

## aicos/components/fota/Kconfig
```kconfig
# General configuration options
#
# Copyright 2021 by AICXTEK TECHNOLOGIES CO.,LTD. All rights reserved.

menu "FOTA"

config FOTA_SUPPORT
    bool "fota"
    depends on SUBSYS_AP
    default n
    help
        Say Y if you want to open FOTA.

choice
    prompt "seletct fota download type"
    default FOTA_HTTP_SUPPORT
    depends on FOTA_SUPPORT
    help
      Select fota download type.

    config FOTA_HTTPS_SUPPORT
        bool "HTTPS type"
        help
          HTTPS download type

    config FOTA_HTTP_SUPPORT
        bool "HTTP type"
        help
          HTTP download type

    config FOTA_FTP_SUPPORT
        bool "FTP type"
        help
          FTP download type

    config FOTA_BY_UART
        bool "fota via uart"
        help
          uart download type

    config FOTA_BY_MCU
        bool "fota via mcu"
        help
          mcu download type
endchoice

config ATFOTA
    bool "fota AT command support"
    default y
    depends on FOTA_SUPPORT
    help
        Say Y if you want to open FOTA AT command.

config FOTA_CERT_SUPPORT
    bool "fota https certificate support"
    default n
    depends on FOTA_SUPPORT
    help
        Say N if you want to disable https certificate.

config COMPLETE_UPGRADE_PKG
    bool "fota use a complete upgrade package."
    default y
    depends on FOTA_SUPPORT

config FOTA_CMIOT_CMD
    bool "fota support cmiot at command"
    default n
    depends on FOTA_SUPPORT
endmenu
```

## aicos/components/fs/Kconfig
```kconfig
# General configuration options
#
# Copyright 2021 by AICXTEK TECHNOLOGIES CO.,LTD. All rights reserved.
#

menu "File System Config"
    config FS
        tristate "File System (FS) support"
        help
            This option will provide the generic support for users to transparently access the
            file system.

if FS
source "components/fs/dev/Kconfig"
source "components/fs/fatfs/Kconfig"
source "components/fs/romfs/Kconfig"
source "components/fs/littlefs/Kconfig"
source "components/fs/at/Kconfig"
source "components/fs/test/Kconfig"
endif
endmenu
```

## aicos/components/fs/at/Kconfig
```kconfig
# General configuration options
#
# Copyright 2021 by AICXTEK TECHNOLOGIES CO.,LTD. All rights reserved.
#

menu "File System AT Config"
    config FS_AT
        tristate "fs at"
        default y
        help
            file system at command.

    config FS_CUSTOM_AT
        tristate "fs custom at"
        help
            file system custom at command.
endmenu
```

## aicos/components/fs/dev/Kconfig
```kconfig
# General configuration options
#
# Copyright 2021 by AICXTEK TECHNOLOGIES CO.,LTD. All rights reserved.
#

menu "File System Device Select"
    config FS_DEV_FLASH
        tristate "flash device fs support"
        default n
        help
            fs direct to storage in flash device.

    config FS_DEV_FTL
        tristate "ftl device fs support"
        default y
        help
            fs use ftl api to storage in flash device.

    config FS_DEV_FILE
        tristate "file device fs support"
        default n
        help
            fs storage in file.

    config FS_DEV_BD
        tristate "block device fs support"
        default n
        help
            fs storage in block device.

    config FS_DEV_RAM
        tristate "ram device fs support"
        default n
        help
            fs storage in ram device.

    config FS_DEV_WIN32
        tristate "win32 device fs support"
        default n
        help
            fs storage in win32 device.
endmenu
```

## aicos/components/fs/fatfs/Kconfig
```kconfig
# General configuration options
#
# Copyright 2021 by AICXTEK TECHNOLOGIES CO.,LTD. All rights reserved.
#

menuconfig FS_FATFS
    tristate "FAT File System support"
    default y
    help
        This option will provide the ffs support for users to transparently access the
        file system.

if FS_FATFS
    config FS_FATFS_IMAGE_GEN
        bool "Generate FATFS image at build time"
        default n
        help
            Generate FATFS image at build time.

    config FS_FATFS_IMAGE_GEN_SIZE
        string "Size of gernerated fatfs image"
        default "1M"
        depends on FS_FATFS_IMAGE_GEN
        help
            Size of the FATFS image, n[K/M/G].

    source "components/fs/fatfs/fxffs/Kconfig"
endif
```
