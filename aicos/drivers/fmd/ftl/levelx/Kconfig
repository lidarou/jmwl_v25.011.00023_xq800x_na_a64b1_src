## aicos/drivers/pmic/adc/Kconfig
```kconfig
# General configuration options
#
# Copyright 2022 by AICXTEK TECHNOLOGIES CO.,LTD. All rights reserved.

menuconfig ADC
    bool "adc Drivers"
    depends on SUBSYS_AP
    default y
    help
      Enable config options for adc drivers.

if ADC

config DRIVER_ADC
    bool "pmic adc driver"
    default y
    help
      adc operate driver.

if PMIC_GP201
    config ADC_R1P0
        bool
        default y
        help
            select adc r1p0 for adc interface.
endif

if PMIC_GP202
    config ADC_R2P0
        bool
        default y
        help
            select adc r2p0 for adc interface.
endif

if ADC_R1P0
    config DRIVER_ADC_VER
        string
        default "r1p0"
endif

if ADC_R2P0
    config DRIVER_ADC_VER
        string
        default "r2p0"
endif

config DRIVER_ADC_DEMO
    bool "pmic adc driver demo"
    depends on DRIVER_ADC
    default n
    help
      adc driver demo for user.

config ADC_BLT_AT_CMD
    bool "adc blt(board level test)driver"
    default y
    help
        adc board level test.

endif # adc
```

## aicos/drivers/pmic/clk_cali/Kconfig
```kconfig
# General configuration options
#
# Copyright 2022 by AICXTEK TECHNOLOGIES CO.,LTD. All rights reserved.
menu "clk cali driver"

config CLK_CALI
    bool "clock calibrate driver"
    depends on PMIC
    help
      Clock calibrate driver

config DCXO_DIAG_CALI_AP
    bool "DCXO diag ap calibrate"
    depends on CLK_CALI && SUBSYS_AP
    help
      Dcxo diag calibrate

config DCXO_DIAG_CALI_CP
    bool "DCXO diag cp calibrate"
    depends on CLK_CALI && SUBSYS_CP
    help
      Dcxo diag calibrate

config RCO32K_CALI
    bool "Rco32k calibrate driver"
    depends on CLK_CALI
    help
      Rco32k calibrate

endmenu
```

## aicos/drivers/pmic/efuse/Kconfig
```kconfig
# General configuration options
#
# Copyright 2022 by AICXTEK TECHNOLOGIES CO.,LTD. All rights reserved.

menuconfig PMIC_EFUSE
    bool "pmic efuse Drivers"
    depends on SUBSYS_AP
    default y
    help
      Enable config options for PMIC EFUSE drivers.

if PMIC_EFUSE

config DRIVER_PMIC_EFUSE
    bool "pmic efuse driver"
    default y
    help
      pmic efuse operate driver.

#PMIC efuse version Selection configurations
choice
    prompt "pmic efuse version Selection"
    default EFUSE_R1P0

    config EFUSE_R1P0
        bool "R1P0 efuse ip"
        help
            select efuse r1p0 for efuse interface.

    config EFUSE_R2P0
        bool "R2P0 efuse ip"
        help
            select efuse r2p0 for efuse interface.
endchoice

if EFUSE_R1P0
    config DRIVER_PMIC_EFUSE_VER
        string
        default "r1p0"
endif

if EFUSE_R2P0
    config DRIVER_PMIC_EFUSE_VER
        string
        default "r2p0"
endif

config DRIVER_PMIC_EFUSE_DEMO
    bool "pmic efuse driver demo"
    depends on DRIVER_PMIC_EFUSE
    default n
    help
      efuse driver demo for user.

endif # EFUSE
```

## aicos/drivers/pmic/gpio/Kconfig
```kconfig
# General configuration options
#
# Copyright 2022 by AICXTEK TECHNOLOGIES CO.,LTD. All rights reserved.

menuconfig PMIC_GPIO
    bool "GPIO Drivers"
    depends on PMIC_GP201 || PMIC_GP202 || PMIC_GP301
    depends on SUBSYS_AP
    default n
    help
      Enable config options for gpio drivers.

if PMIC_GPIO
config DRV_GPIO_PMIC
    bool "PMIC GPIO driver"
    default n
    help
      PMIC GPIO IP

config DRV_GPIO_PMIC_VER
    string "PMIC GPIO driver IP version"
    depends on DRV_GPIO_PMIC
    default "gp201"
    help
      PMIC GPIO IP version, different chip will use different version
      of pmic gpio IP.
endif
```

## aicos/drivers/pmic/kpled/Kconfig
```kconfig
# General configuration options
#
# Copyright 2022 by AICXTEK TECHNOLOGIES CO.,LTD. All rights reserved.

menuconfig KPLED
    bool "kpled driver"
    depends on SUBSYS_AP
    select PMIC_PMU
    default n
    help
      enalbe kpled driver.

if KPLED

config DRIVER_KPLED
    bool "pmic kpled driver"
    default y
    help
      pmic kpled driver operate.

#PMIC pmu version Selection configurations
choice
    prompt "kpled version Selection"
    default KPLED_R1P0

    config KPLED_R1P0
        bool "kpled driver r1p0"
        help
            select kpled driver r1p0.

    config KPLED_R2P0
        bool "kpled driver r2p0"
        help
            select kpled driver r2p0.
endchoice

if KPLED_R1P0
    config DRIVER_KPLED_VER
        string
        default "r1p0"
endif

if KPLED_R2P0
    config DRIVER_KPLED_VER
        string
        default "r2p0"
endif

config DRIVER_KPLED_DEMO
    bool "kpled demo"
    depends on DRIVER_KPLED
    default n
    help
      kpled users demo.
endif
```
