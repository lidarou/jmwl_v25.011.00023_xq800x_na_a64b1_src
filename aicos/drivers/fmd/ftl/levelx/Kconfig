## aicos/drivers/fmd/ftl/levelx/Kconfig
```kconfig
# General configuration options
#
# Copyright 2021 by AICXTEK TECHNOLOGIES CO.,LTD. All rights reserved.
#

menuconfig AZURE_LEVELX
    tristate "Azure levelX support"
    help
      LevelX provides wearing level and power loss resilience for flash. 

if AZURE_LEVELX

config LX_USE_NAND_FLASH
    tristate "Use Nand Flash"
    depends on AZURE_LEVELX
    help
        Enable Use Nand Flash

config LX_USE_NOR_FLASH
    tristate "Use Nor Flash"
    depends on AZURE_LEVELX
    help
        Enable Use Nor Flash

if LX_USE_NOR_FLASH

config LX_NOR_EXTENDED_CACHE
    tristate "Use Extended cache"
    depends on LX_USE_NOR_FLASH
    help
        Enable Use Extended cache

endif

endif
```

## aicos/drivers/fmd/snor/Kconfig
```kconfig
# General configuration options
#
# Copyright 2021 by AICXTEK TECHNOLOGIES CO.,LTD. All rights reserved.
#

menuconfig FMD_SNOR
    tristate "spi nor flash support"
    depends on FMD
    help
        This is the hardware abastraction layer for the spi nor flash.

if FMD_SNOR
config FLASH_XIP
    tristate "FLASH XIP support"
    depends on FMD_SNOR
    help
        This enables support for FLASH XIP.
endif
```

## aicos/drivers/gpd/Kconfig
```kconfig
# General configuration options
#
# Copyright 2022 by AICXTEK TECHNOLOGIES CO.,LTD. All rights reserved.

menuconfig GPD
    bool "GPD Drivers"
    depends on SUBSYS_AP
    default y
    help
      Enable config options for gpd drivers.

if GPD

config DRIVER_GPD
    bool "GPD driver"
    default n
    help
      Define General Pulse Detecter driver IP

config DRIVER_GPD_VER
    string "GPD driver IP version"
    depends on DRIVER_GPD
    default "r1p0"
    help
      GPD IP version, different chip will use different version
      of gpd IP.

endif # GPD
```

## aicos/drivers/gpio/Kconfig
```kconfig
# General configuration options
#
# Copyright 2022 by AICXTEK TECHNOLOGIES CO.,LTD. All rights reserved.

menuconfig GPIO
    bool "GPIO Drivers"
    default n
    help
      Enable config options for gpio drivers.

if GPIO

config DRIVER_GPIO
    bool "GPIO driver"
    default n
    help
      Timer IP, use for schedule or timestamp

config DRIVER_GPIO_VER
    string "GPIO driver IP version"
    depends on DRIVER_GPIO
    default "cnds"
    help
      GPIO IP version, different chip will use different version
      of gpio IP.

config GPIO_NETLIGHT_SAMPLE
    bool "GPIO Network light sample"
    depends on DRIVER_GPIO
    depends on SUBSYS_AP
    default n
    help
       Select GPIO network light sample.

endif # GPIO
```

## aicos/drivers/gpo/Kconfig
```kconfig
# General configuration options
#
# Copyright 2024 by AICXTEK TECHNOLOGIES CO.,LTD. All rights reserved.

menu "GPO Drivers"

config DRIVER_GPO
    bool "GPO driver"
    default n
    help
      GPO IP, use for GPO pin

config DRIVER_GPO_VER
    string "GPO driver IP version"
    depends on DRIVER_GPO
    default "r1p0"
    help
      GPO IP version, different chip will use different version
      of gpo IP.

endmenu # GPO Drivers
```

## aicos/drivers/graphics/Kconfig
```kconfig
# General configuration options
#
# Copyright 2022 by AICXTEK TECHNOLOGIES CO.,LTD. All rights reserved.

menuconfig GRAPHICS
    bool "Graphics Drivers"
    depends on SUBSYS_AP
    help
      Enable config options for gpio drivers.

if GRAPHICS

config DRIVER_LCDC
    bool "lcdc driver"
    default y
    help
      SoC efuse operate driver.

config SYNC_FLIP
    bool "lcdc flip sync"
    depends on DRIVER_LCDC
    default n
    help
        lcdc flip interface return until flip finish.

choice
    prompt "lcd panel selection."
    default ST7789

    config ST7789
        bool "ST7789 lcd panel"
        depends on DRIVER_LCDC
        help
          ST7789 lcd panel.

    config GC9306
        bool "GC9306 lcd panel"
        depends on DRIVER_LCDC
        help
          GC9306 lcd panel.

    config GC9307
        bool "GC9307 lcd panel"
        depends on DRIVER_LCDC
        help
          GC9307 lcd panel.

    config IPS9107
        bool "IPS9107 lcd panel"
        depends on DRIVER_LCDC
        help
          IPS9107 lcd panel.

    config ST7315
        bool "ST7315 lcd panel"
        depends on DRIVER_LCDC
        help
          ST7315 lcd panel.

    config ST7365
        bool "ST7365 lcd panel"
        depends on DRIVER_LCDC
        help
          ST7365 lcd panel.

    config ST7567
        bool "ST7567 lcd panel"
        depends on DRIVER_LCDC
        help
          ST7567 lcd panel.

    config ST7735
        bool "ST7735 lcd panel"
        depends on DRIVER_LCDC
        help
          ST7735 lcd panel.

    config AXS15231B
        bool "AXS15231B lcd panel"
        depends on DRIVER_LCDC
        help
          AXS15231B lcd panel.
endchoice

config DRIVER_BACKLIGHT
    bool "lcd panel backlight"
    depends on DRIVER_LCDC
    default y
    help
      lcd panel backlight.

choice
    prompt "lcd panel backlight type selection"
    default KPLED_BACKLIGHT

    config KPLED_BACKLIGHT
        bool "KPLED panel backlight"
        depends on DRIVER_BACKLIGHT
        help
            kpled lcd panel backlight.

    config PWM_BACKLIGHT
        bool "PWM panel backlight"
        depends on DRIVER_BACKLIGHT
        help
            kpled lcd panel backlight.

    config PULSE_DIMMING_BACKLIGHT
        bool "pluse dimming panel backlight"
        depends on DRIVER_BACKLIGHT
        help
            pluse dimming panel backlight.

    config LED_RGBW_BACKLIGHT
        bool "LED RGBW panel backlight"
        depends on DRIVER_BACKLIGHT
        select LAMP
        help
            led_rgbw lcd panel backlight.
endchoice

if LED_RGBW_BACKLIGHT
config LED_RGBW_BACKLIGHT_MAX_CURRENT
    int "led rgbw backlight max current"
    default 81600
    help
        led rgbw backlight max current.
endif

config DISPLAY_SHOWLOGO
    bool "display show startup logo"
    default y
    help
      display show startup logo.

config AIC_DISPLAY_AT
    bool "display aic at support"
    default y
    help
      display aic at support.

config PANEL_POWER_PMIC
    bool "lcd panel power supply from pmic ldo"
    default y
    help
        lcd panel power supply from pmic ldo.

config TP
    bool "Enable touch panel support"
    default n
    
choice
    bool "Touch panel selection"
    depends on TP
    default BL6XX3

    config BL6XX3
        bool "BL6XX3 touch panel"
        help
          BL6XX3 touch panel.

endchoice

endif # graphics Configurations
```

## aicos/drivers/hlzma/Kconfig
```kconfig
# General configuration options
#
# Copyright 2021 by AICXTEK TECHNOLOGIES CO.,LTD. All rights reserved.
# lzma software decoder configurations
#

menuconfig HLZMA
    bool "HLZMA Drivers"
    depends on SUBSYS_AP
    default n
    help
      Enable config options for hlzma drivers.

if HLZMA

config DRIVER_HLZMA
    bool "Hardware lzma driver"
    default n

config DRIVER_HLZMA_VER
    string "Hardware lzma ip version selection"
    depends on DRIVER_HLZMA
    default "r1p0"
    help
      HLZMA ip version, select correct version for specified project.

config BYPASS_HLZMA_EB
    bool "Not disable eb after work done"
    depends on DRIVER_HLZMA
    default n

endif # HLZMA
```

## aicos/drivers/i2c/Kconfig
```kconfig
# General configuration options
#
# Copyright 2021 by AICXTEK TECHNOLOGIES CO.,LTD. All rights reserved.

menuconfig I2C
    bool "I2C Drivers"
    depends on SUBSYS_AP
    default y
    help
      Enable config options for i2c drivers.

if I2C

config DRIVER_I2C
    bool "Driver I2C"
    default n
    help
      Select I2C driver.

config DRIVER_I2C_TEST
    bool "Driver I2C test"
    depends on DRIVER_I2C
    default n
    help
      Select I2C test driver.

endif # I2C
```

## aicos/drivers/iis/Kconfig
```kconfig
# General configuration options
#
# Copyright 2021 by AICXTEK TECHNOLOGIES CO.,LTD. All rights reserved.

menuconfig IIS
    bool "IIS Drivers"
    depends on SOUND_SUPPORT
    default n
    help
      Enable config options for iis drivers.

if IIS

choice
    prompt "IIS version selection"
    default IIS_R1P0

    config IIS_R1P0
        bool "r1p0"
        help
            gx31x iis

    config IIS_R2P0
        bool "r2p0"
        help
            gx30x iis
endchoice

if IIS_R1P0
    config IIS_VERSION
        string
        default "r1p0"
endif

if IIS_R2P0
    config IIS_VERSION
        string
        default "r2p0"
endif

config DRIVER_IIS
    bool "Driver IIS module"
    default n
    depends on SOUND_SUPPORT
    help
      Select IIS module.

endif # IIS
```

## aicos/drivers/ipu/Kconfig
```kconfig
# General configuration options
#
# Copyright 2021 by AICXTEK TECHNOLOGIES CO.,LTD. All rights reserved.

menuconfig IPU
    bool "IPU Drivers"
    default n
    help
      Enable config options for ipu drivers.

if IPU

config IPU_DRIVER
    bool "Driver IPU module"
    default n
    help
      Select ipu module.

endif
```

## aicos/drivers/kpc/Kconfig
```kconfig
# General configuration options
#
# Copyright 2021 by AICXTEK TECHNOLOGIES CO.,LTD. All rights reserved.

menuconfig KPC
    bool "KPC Drivers"
    depends on SUBSYS_AP
    help
      Enable config options for keypad controller drivers.

if KPC

comment "Driver Keypad Controller has been enabled."

config KPC_DEMO_FUNC
    bool "KPC support Demo Function [Camera Pre & Show LOGO]"
    depends on KPC
    default n
    help
      Whether KPC support Demo Function. Camer Preview depends on CAMERA_SUPPORT.

endif # KPC
```

## aicos/drivers/lzma/Kconfig
```kconfig
# General configuration options
#
# Copyright 2021 by AICXTEK TECHNOLOGIES CO.,LTD. All rights reserved.
# lzma software decoder configurations
#

menuconfig LZMA
    bool "LZMA Drivers"
    help
      Enable config options for LZMA drivers.

if LZMA

config DRIVER_LZMA_DEC
    bool "LZMA sw decoder"
    default y

endif
```

## aicos/drivers/mha/Kconfig
```kconfig
# General configuration options
#
# Copyright 2022 by AICXTEK TECHNOLOGIES CO.,LTD. All rights reserved.

menuconfig MHA
    bool "MHA Drivers"
    help
      Enable config options for MHA drivers.

if MHA

config MHA_PIN
    bool "MHA PIN"
    default n
    depends on MHA
    help
      Enable config options for MHA PIN.

config MHA_LCD
    bool "MHA LCD"
    default n
    depends on MHA
    help
      Enable config options for MHA LCD.

config MHA_CAMERA
    bool "MHA CAMERA"
    default n
    depends on MHA
    help
      Enable config options for MHA CAMERA.

config MHA_SOUND
    bool "MHA SOUND"
    default n
    depends on MHA
    help
      Enable config options for MHA SOUND.

endif # MHA
```

## aicos/drivers/misc/Kconfig
```kconfig
# General configuration options
#
# Copyright 2021 by AICXTEK TECHNOLOGIES CO.,LTD. All rights reserved.
#

menuconfig MISC
    bool "MISC Drivers"
    help
      Enable config options for misc drivers.

if MISC

config DRIVER_MISC
    bool "misc driver, such as fpga id,eda debug"
    default y

endif
```

## aicos/drivers/modem_sys/Kconfig
```kconfig
# General configuration options
#
# Copyright 2021 by AICXTEK TECHNOLOGIES CO.,LTD. All rights reserved.

menuconfig MODEMSYS
    bool "MODEMSYS Drivers"
    depends on SUBSYS_CP
    help
      Enable config options for modem sys drivers.

if MODEMSYS

config DRIVER_MODEMSYS
    bool "Modem ctrl driver"
    depends on SUBSYS_CP
    default y

endif # MODEMSYS
```

## aicos/drivers/network/Kconfig
```kconfig
# General configuration options
#
# Copyright 2021 by AICXTEK TECHNOLOGIES CO.,LTD. All rights reserved.

menu "Network Driver Configurations"

config NET_DRIVER
    bool "net driver component"
	depends on AZURE_NETXDUO || USE_LWIP
    default n

config NET_ALTE_DRIVER
    bool "cellular network driver component"
    depends on NET_DRIVER
    default n

config NET_IMS_NIC
    bool "ims nic component"
    depends on NET_DRIVER
    default n

config NET_PPP_CODEC
    bool "ppp codec accelerate"
    depends on NET_DRIVER
    default n

config NET_PPP_CODEC_PHY_V1
    bool "ppp codec HW accelerate version v1.0"
    depends on NET_PPP_CODEC
    default n

config NET_DATA_FORWARD
    bool "network data forward"
    depends on NET_DRIVER
    default n

config D2D_DATA_FORWARD
    bool "d2d data forward"
    depends on NET_DRIVER
    default n

config NET_VIRT_NIC
    bool "Virtual nic driver"
    depends on NET_DRIVER && CMUX
    default n

config NET_DRIVER_TEST
    bool "Network driver test component"
    depends on NET_DRIVER
    default n

config NET_DRIVER_IPV4_TCP_TEST
    bool "Network driver ipv4 tcp test component"
    depends on NET_DRIVER && NET_DRIVER_TEST
    default n

config NET_DRIVER_IPV4_UDP_TEST
    bool "Network driver ipv4 udp test component"
    depends on NET_DRIVER && NET_DRIVER_TEST
    default n

config NET_DRIVER_IPV6_TCP_TEST
    bool "Network driver ipv6 tcp test component"
    depends on NET_DRIVER && NET_DRIVER_TEST
    default n

config NET_DRIVER_IPV6_UDP_TEST
    bool "Network driver ipv6 udp test component"
    depends on NET_DRIVER && NET_DRIVER_TEST
    default n

config NET_DRIVER_IPV4_RAW_TEST
    bool "bsd raw socket ipv4 test"
    depends on NET_DRIVER && NET_DRIVER_TEST
    default n

endmenu
```

## aicos/drivers/pcdump/Kconfig
```kconfig
# General configuration options
#
# Copyright 2022 by AICXTEK TECHNOLOGIES CO.,LTD. All rights reserved.

menuconfig PCDUMP
    bool "PCDUMP CR5 Drivers"
    depends on SUBSYS_AP
    help
      Enable config options for CR5 pc dump drivers.

if PCDUMP

config DRIVER_PCDUMP
    bool "PCDump driver"
    default n
    help
      PCDump IP used to dump CR5 generic register by AP.

endif # PCDUMP
```

## aicos/drivers/perf/Kconfig
```kconfig
# General configuration options
#
# Copyright 2023 by AIC Micro Corporation. All rights reserved.

menu "Performance Monitor Options"

    config DRIVER_PERFORMANCE
        bool "Performance Monitor module"
        depends on SUBSYS_AP
        default n
        help
          Performance Monitor module.

    config PERFORMACNE_VER
        string "PERF MONITOR IP version"
        depends on DRIVER_PERFORMANCE
        default "r2p0"
        help
          PERF MONITOR IP version, different chip will use different version PERF MONITOR IP.
endmenu
```

## aicos/drivers/pin_ctrl/Kconfig
```kconfig
# General configuration options
#
# Copyright 2022 by AICXTEK TECHNOLOGIES CO.,LTD. All rights reserved.

menuconfig PIN_CTRL
    bool "Pin control drivers"
    help
      Enable config options for pin control drivers.

if PIN_CTRL

config DRIVER_PIN_CTRL
    bool "Pin control driver"
    default y
    help
      Pin module driver.

config FIX_BID012
    bool "fix bug 012"
    default n
    help
      Pin module driver.

config FIX_BID013
    bool "fix bug 013"
    default n
    help
      Pin module driver.

endif
```

## aicos/drivers/pmic/Kconfig
```kconfig
# General configuration options
#
# Copyright 2022 by AICXTEK TECHNOLOGIES CO.,LTD. All rights reserved.

if PMIC
    menu "PMIC Drivers Options"
    #source other driver components Kconfig
    source "drivers/pmic/*/Kconfig"
    endmenu # PMIC Drivers
endif
```
