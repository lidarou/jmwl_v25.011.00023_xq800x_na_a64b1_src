## aicos/drivers/pmic/lamp/Kconfig
```kconfig
# General configuration options
#
# Copyright 2022 by AICXTEK TECHNOLOGIES CO.,LTD. All rights reserved.

menuconfig LAMP
    bool "lamp driver"
    depends on SUBSYS_AP
    select PMIC_PMU
    default y
    help
      enalbe lamp driver.

if LAMP

config DRIVER_LAMP
    bool "pmic lamp driver"
    default y
    help
      pmic lamp driver operate.

if DRIVER_LAMP
choice
    prompt "lamp unit version Selection"
    default LAMP_GP201

    config LAMP_GP201
        bool "gp201 lamp units"
        help
            select gp201 units for lamp units group.
endchoice

    config LED_R
        bool "choice LED_R as lamp source"
        default y
        help
            choice LED_R as lamp source.

    config LED_G
        bool "choice LED_G as lamp source"
        default y
        help
            choice LED_G as lamp source.

    config LED_B
        bool "choice LED_B as lamp source"
        default y
        help
            choice LED_B as lamp source.

    config LED_W
        bool "choice LED_W as lamp source"
        help
            choice LED_W as lamp source.

config LAMP_INIT_CURRENT
    int "lamp init current val"
    default 60000
    help
        lamp init current val.

if LAMP_GP201
    config DRIVER_LAMP_VER
        string
        default "gp201"
endif

config LED_BLT_AT_CMD
    bool "led board level test driver"
    depends on DRIVER_LAMP
    depends on BLT_SUPPORT
    default y
    select LED_R
    select LED_G
    select LED_B
    select LED_W
    help
        RGBW LED board level test.
endif

config DRIVER_LAMP_DEMO
    bool "lamp demo"
    depends on DRIVER_LAMP
    default n
    help
      lamp users demo.
endif
```

## aicos/drivers/pmic/lpr/Kconfig
```kconfig
# General configuration options
#
# Copyright 2023 by AICXTEK TECHNOLOGIES CO.,LTD. All rights reserved.
menu "LongPressReset Configurations"

config LPR
    bool "lpc driver"
    depends on SUBSYS_AP
    default y
    help
        long press reset api.

if LPR
config DRIVER_AT_LPR
    bool "lpr at command"
    depends on LPR
    default y
    help
      Monitor system temperature.
endif
endmenu # lpr Configurations
```

## aicos/drivers/pmic/pmic_2nd_irq/Kconfig
```kconfig
# General configuration options
#
# Copyright 2022 by AICXTEK TECHNOLOGIES CO.,LTD. All rights reserved.
# pmic irq configurations

menuconfig PMIC_2ND_IRQ
    bool "pmic 2nd irq driver"
    depends on SUBSYS_AP && PMIC_IRQ
    default y
    help
      Select pmic 2nd irq driver for support pmic 2nd irq request.

if PMIC_2ND_IRQ

if PMIC_GP201
    config DRIVER_PMIC_PMU_VER
        string
        default "GP201"
endif

if PMIC_GP202
    config DRIVER_PMIC_PMU_VER
        string
        default "GP202"
endif

if PMIC_GP301
    config DRIVER_PMIC_PMU_VER
        string
        default "GP301"
endif

endif
```

## aicos/drivers/pmic/pmic_clk/Kconfig
```kconfig
# General configuration options
#
# Copyright 2022 by AICXTEK TECHNOLOGIES CO.,LTD. All rights reserved.
menu "pmic clk driver"

config PMIC_CLK
    bool "pmic clock driver"
    depends on PMIC
    help
      pmic clock driver

endmenu
```

## aicos/drivers/pmic/pmic_irq/Kconfig
```kconfig
# General configuration options
#
# Copyright 2022 by AICXTEK TECHNOLOGIES CO.,LTD. All rights reserved.
# pmic irq configurations

menuconfig PMIC_IRQ
    bool "pmic irq driver"
    depends on SUBSYS_AP
    select PMIC_2ND_IRQ
    default y
    help
      Select pmic irq driver for support pmic irq request.

    choice
        prompt "pmic ipu phy driver"
        default PMIC_IPU_R1P0

        config PMIC_IPU_R1P0
            bool "pmic ipu r1p0 driver."
            depends on PMIC_IRQ
            help
              pmic ipu r1p0 driver.

        config PMIC_IPU_R2P0
            bool "pmic ipu r2p0 driver."
            depends on PMIC_IRQ
            help
              pmic ipu r1p0 driver.
    endchoice

    if PMIC_IPU_R1P0
        config DRIVER_PMIC_IPU_VER
            string
            default "r1p0"
    endif

    if PMIC_IPU_R2P0
        config DRIVER_PMIC_IPU_VER
            string
            default "r2p0"
    endif
```

## aicos/drivers/pmic/pmu/Kconfig
```kconfig
# General configuration options
#
# Copyright 2022 by AICXTEK TECHNOLOGIES CO.,LTD. All rights reserved.

menuconfig PMIC_PMU
    bool "pmu subsys & driver"
    default y
    help
      Enable config options for pmic pmu subsys & drivers.

if PMIC_PMU

config DRIVER_PMIC_PMU
    bool "pmic pmu driver"
    default y
    help
      pmic pmu operate driver.

config DRIVER_PMIC_PMU_DEMO
    bool "pmic pmu user demo"
    depends on DRIVER_PMIC_PMU
    default n
    help
      pmu users demo.

config MHA_PA_POWER
    bool "multi-hardware adapt pa power supply"
    default n
    help
      multi-hardware adapt pa power supply.

config PMIC_PMU_AT
    bool "pmic pmu at"
    depends on SUBSYS_AP
    default n
    help
      pmic pmu at cmd operate.

config PA_VBAT_POWER
    bool "VBAT Power RF PA"
    depends on SUBSYS_AP
    depends on PMIC_GP201
    default n
    help
      VBAT Power RF PA.
endif
```

## aicos/drivers/pmic/power_supply/Kconfig
```kconfig
# General configuration options
#
# Copyright 2022 by AICXTEK TECHNOLOGIES CO.,LTD. All rights reserved.
# pmic irq configurations

menuconfig POWER_SUPPLY
    bool "Power Supply"
    depends on SUBSYS_AP && PMIC_IRQ
    default y
    help
      Select pmic power supply (batteries, AC, USB) driver for power supply service.

    config AIC_POWER_SUPPLY_AT
        bool "aic power supply at cmd support."
        depends on POWER_SUPPLY
        default y
        help
            aic power supply at cmd support.

    config POWER_SUPPLY_CORE
        bool "power supply core logic"
        depends on POWER_SUPPLY
        select CHGR
        default y
        help
            power supply core logic.

if POWER_SUPPLY
#source other power supply driver components Kconfig
source "drivers/pmic/power_supply/*/Kconfig"
endif
```

## aicos/drivers/pmic/power_supply/battery/Kconfig
```kconfig
# General configuration options
#
# Copyright 2022 by AICXTEK TECHNOLOGIES CO.,LTD. All rights reserved.
# pmic power supply battery configurations

menuconfig BAT
    bool "battery driver."
    default n
    help
         battery capacity statistacil report.

if BAT
    # battery driver Selection configurations
    choice
        prompt "battery driver Selection"
        default BAT_R1P0

        config BAT_R1P0
            bool "R1P0 battery ip"
            help
                select battery r1p0 for battery interface.

        config BAT_R2P0
            bool "R2P0 battery ip"
            help
                select battery r2p0 for battery interface.
    endchoice

    if BAT_R1P0
        config BAT_IP
            string
            default "r1p0"
    endif

    if BAT_R2P0
        config BAT_IP
            string
            default "r2p0"
    endif
endif
```

## aicos/drivers/pmic/power_supply/charger/Kconfig
```kconfig
# General configuration options
#
# Copyright 2022 by AICXTEK TECHNOLOGIES CO.,LTD. All rights reserved.
# pmic power supply configurations

menuconfig CHGR
    bool "charger driver."
    select BAT
    select BCD
    default n
    help
      provide AC&USB charging operate api.

if CHGR
    # AIC SoC PMIC charging Selection configurations
    choice
        prompt "PMIC CHARGER Selection"
        default CHGR_GP201

        config CHGR_GP201
            bool "gp201 charging ip"
            help
                select gp201 for charging interface.

        config CHGR_AUTO_IC
            bool "external auto charger ic"
            help
                select external auto charger ic for charging interface.

        config CHGR_EXT_CTRL_IC
            bool "external ctrl charger ic"
            help
                select external ctrl charger ic for charging interface.

        config FAST_CHARGER_IC
            bool "external fast charge"
            help
                select external fast charge for charging interface.
    endchoice

    if CHGR_GP201
        config CHGR_IP
            string
            default "gp201"
    endif

    if CHGR_AUTO_IC
        config CHGR_IP
            string
            default "dummy"
    endif

    if CHGR_EXT_CTRL_IC
        config CHGR_IP
            string
            default "ext_ctrl_chg"
    endif

    if FAST_CHARGER_IC
        config CHGR_IP
            string
            default "fast_charger_ic"
    endif
endif
```

## aicos/drivers/pmic/pwr_key/Kconfig
```kconfig
# General configuration options
#
# Copyright 2022 by AICXTEK TECHNOLOGIES CO.,LTD. All rights reserved.
# pmic irq configurations

menuconfig PWRKEY_SW_ACTION
    bool "power key software behavior implement"
    depends on SUBSYS_AP && PMIC_IRQ
    default y
    help
      power key software action implement.

if PWRKEY_SW_ACTION
#Power key function select
choice
    prompt "power key function select"
    default PWR_KEY_LONG_PRESS_SHUTDOWN
        depends on PWRKEY_SW_ACTION

config PWR_KEY_LONG_PRESS_SHUTDOWN
    bool "power key control backlight & long press shutdown."
    help
      power key control backlight & long press shutdown.

config PWR_KEY_KICK_SHUTDOWN
    bool "power key kick shutdown."
    help
      press power key to turn off system.

config PWR_KEY_GND
    bool "power key connected to ground."
    help
      power key connected to ground

config DISABLE_CHG_IN_BOOT_LPR
    bool "disable charge_in boot LPR"
    help
      disable charge_in boot LPR
endchoice

config PWR_KEY_KICK_SWITCH_BACKLIGHT
    bool "pmic pwr key kick switch backlight status"
    depends on PWR_KEY_LONG_PRESS_SHUTDOWN
    default y
    help
        pmic pwr key kick switch backlight status.

if PWR_KEY_LONG_PRESS_SHUTDOWN
config PWR_KEY_LINK_VBUS
    bool "usb plug-in trigger pwrkey grounding"
    default n
    help
        usb plug-in trigger pwrkey grounding.

if !PWR_KEY_LINK_VBUS
    config PWR_KEY_LINK_GND_QUICK_SLEEP
        bool "HW Design pwrkey link GND quick sleep"
        default n
        help
            HW Design pwrkey link GND quick sleep.
endif
endif
endif
```

## aicos/drivers/pmic/rtc/Kconfig
```kconfig
# General configuration options
#
# Copyright 2022 by AICXTEK TECHNOLOGIES CO.,LTD. All rights reserved.

menuconfig PMIC_RTC
    bool "RTC Drivers"
    depends on PMIC_GP201 || PMIC_GP202 || PMIC_GP301
    default n
    help
      Enable config options for rtc drivers.

if PMIC_RTC
config DRV_RTC_PMIC
    bool "PMIC RTC driver"
    default n
    help
      PMIC RTC IP

config DRV_RTC_PMIC_VER
    string "PMIC RTC driver IP version"
    depends on DRV_RTC_PMIC
    default "gp201"
    help
      PMIC RTC IP version, different chip will use different version
      of pmic rtc IP.

endif
```

## aicos/drivers/pmic/status_light/Kconfig
```kconfig
# General configuration options
#
# Copyright 2024 by AICXTEK TECHNOLOGIES CO.,LTD. All rights reserved.

menuconfig STATUS_LIGHT
    bool "status_light"
    depends on SUBSYS_AP
    default n
    help
        status light driver.

if STATUS_LIGHT

config DRIVER_STATUS_LIGHT
    bool "device/net status light"
    depends on STATUS_LIGHT
    default n
    help
        device net status light.

config NET_STATUS_LIGHT_API
    bool "net status light api support."
    depends on STATUS_LIGHT
    select PIN_WAKEUP
    default n
    help
        device net status light api.
endif
```

## aicos/drivers/pmic/tsc/Kconfig
```kconfig
# General configuration options
#
# Copyright 2022 by AIC Micro Corporation. All rights reserved.

menuconfig TSC
    bool "TSC Module"
    depends on SUBSYS_AP
    depends on GRAPHICS
    select PMIC_GPIO
    select DRV_GPIO_PMIC
    select PIN_CTRL
    select DRIVER_PIN_CTRL
    default n
    help
      Enable config options for TSC drivers.
```

## aicos/drivers/pmic/ups/Kconfig
```kconfig
# General configuration options
#
# Copyright 2022 by AICXTEK TECHNOLOGIES CO.,LTD. All rights reserved.

menuconfig PMIC_UPS
    bool "UPS Drivers"
    depends on PMIC_GP201 || PMIC_GP202 || PMIC_GP301
    depends on SUBSYS_AP
    default n
    help
      Enable config options for ups drivers.

if PMIC_UPS
config DRV_UPS
    bool "PMIC UPS driver"
    default n
    help
      PMIC UPS IP

config DRV_UPS_VER
    string "PMIC UPS driver IP version"
    depends on DRV_UPS
    default "gp201"
    help
      PMIC UPS IP version, different chip will use different version
      of pmic ups IP.

config DEF_UPS_MODE
    bool "Enable UPS mode by default"
    depends on DRV_UPS
    default n
    help
      Enable UPS mode by default, it will be enabled when boot up.

endif
```

## aicos/drivers/pmic/wdt/Kconfig
```kconfig
# General configuration options
#
# Copyright 2022 by AICXTEK TECHNOLOGIES CO.,LTD. All rights reserved.
menu "pmic watchdog Configurations"

config PMIC_WDT
    bool "pmic watchdog timer driver"
    select PMIC_IRQ
    depends on SUBSYS_AP
    default y
    help
      Monitor system scheduling exceptions via wdt.

config PMIC_WDT_VER
    string "pmic wdt driver version"
    depends on PMIC_WDT
    default "r2p0"
    help
      Select version that match witch pmic wdt IP.

config PMIC_WATCHDOG_INDEPENDENT_THREAD
    bool "pmic watchdog independent thread"
    depends on PMIC_WDT
    default n
    help
      Create pmic watchdog independent thread for system exception monitoring.

endmenu # pmic watchdog Configurations
```

## aicos/drivers/pmic_i2c/Kconfig
```kconfig
# General configuration options
#
# Copyright 2021 by AICXTEK TECHNOLOGIES CO.,LTD. All rights reserved.

menuconfig PMIC_I2C
    bool "PMIC_I2C Drivers"
    help
      Enable config options for PMIC I2C drivers.

if PMIC_I2C

config PMIC_I2C_DRIVER
    bool "Driver PMIC I2C module"
    default n
    help
      Select PMIC I2C module.

config PMIC_I2C_TEST
    bool "PMIC I2C module test"
    depends on PMIC_I2C
    default n
    help
      Select PMIC I2C module test.

config PMIC_I2C_GP201
    bool "PMIC I2C GP201 test"
    depends on PMIC_I2C
    default n
    help
      Select PMIC I2C GP201 test.

endif
```

## aicos/drivers/psram/Kconfig
```kconfig
# General configuration options
#
# Copyright 2021 by AICXTEK TECHNOLOGIES CO.,LTD. All rights reserved.
#
menuconfig PSRAM
    bool "PSRAM Drivers"
    depends on SUBSYS_AP || SUBSYS_CP
    help
      Enable config options for PSRAM drivers.

if PSRAM

config PSRAM_DRIVER
    bool "Driver PSRAM module"
    default n
    help
      Select PSRAM module.

config PSRAM_DRIVER_VER
    string "PSRAM IP version"
    depends on PSRAM_DRIVER
    default "r1p0"
    help
      PSRAM IP version, different chip will use different version PSRAM IP.

endif
```

## aicos/drivers/pwm/Kconfig
```kconfig
# General configuration options
#
# Copyright 2022 by AICXTEK TECHNOLOGIES CO.,LTD. All rights reserved.

menuconfig PWM
    bool "PWM Drivers"
    depends on SUBSYS_AP
    help
      Enable config options for PWM drivers.

if PWM

config PWM_DRIVER
    bool "Driver PWM module"
    default n
    help
      Select PWM module.

config PWM_AT
    bool "PWM at command support."
    depends on PWM_DRIVER
    default n
    help
      Select PWM module.

endif
```

## aicos/drivers/qspi/Kconfig
```kconfig
# General configuration options
#
# Copyright 2021 by AICXTEK TECHNOLOGIES CO.,LTD. All rights reserved.
#

menuconfig SNC_QSPI
    tristate "QSPI controller"
    help
        This enables support for the QSPI controller.

if SNC_QSPI

config QSPI_DRIVER
    bool "Driver QSPI module"
    default n
    help
      Select QSPI module.

config QSPI_DRIVER_VER
    string "QSPI IP version"
    depends on QSPI_DRIVER
    default "r1p0"
    help
      QSPI IP version, different chip will use different version QSPI IP.

endif
```
