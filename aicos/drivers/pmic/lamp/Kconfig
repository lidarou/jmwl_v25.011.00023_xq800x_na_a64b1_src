## aicos/drivers/sdmmc/Kconfig
```kconfig
# General configuration options
#
# Copyright 2022 by AIC Micro Corporation. All rights reserved.

config DRIVER_SDMMC
    bool "sdmmc driver support"
    depends on SUBSYS_AP
    default n
    help
      sdmmc driver support

choice
	prompt "sdmmc driver selection"
	default SDMMC_SDIO
	help
	  This menu uses to select sdmmc driver.
	  It includes sd/sdio/emmc drivers.

	config SDMMC_SD
		bool "sd driver support"
		depends on DRIVER_SDMMC
		help
		  sdmmc driver for sd support

	config SDMMC_SDIO
		bool "sdio driver support"
		depends on DRIVER_SDMMC
		help
		  sdmmc driver for sdio support

	config SDMMC_EMMC
		bool "emmc driver support"
		depends on DRIVER_SDMMC
		help
		  sdmmc driver for emmc support
endchoice

choice
	prompt "sdmmc phy selection"
	default SDMMC_ASICPHY
	help
	  This menu uses to select sdmmc phy.
	  It includes asic phy / fpga phy.

	config SDMMC_ASICPHY
		bool "sdmmc asic combo phy driver"
		depends on DRIVER_SDMMC
		help
		  sdmmc asic combo phy driver support

	config SDMMC_FPGAPHY
		bool "sdmmc fpga combo phy driver"
		depends on DRIVER_SDMMC
		help
		  sdmmc fpga combo phy driver support
endchoice
```

## aicos/drivers/serial/Kconfig
```kconfig
# General configuration options
#
# Copyright 2021 by AICXTEK TECHNOLOGIES CO.,LTD. All rights reserved.

menuconfig UART
    bool "UART Drivers"
    help
      Enable config options for UART drivers.

if UART

config DRIVER_UART
    bool "Uart driver"
    default n

choice
    prompt "Select uart driver"
    default DRIVER_UART_AIC
config DRIVER_UART_XIL
    bool "xil uart for cr5 dev board"
    depends on DRIVER_UART
    help
      Select xil uart driver for cr5 dev board

config DRIVER_UART_AIC
    bool "enable AIC uart"
    depends on DRIVER_UART
    help
      Select AIC uart driver for aic dev board

if DRIVER_UART_AIC
    config DRIVER_UART_AIC_VERSION
    string "AIC SERIAL IP version"
    default "r1p0"
    help
        AIC SERIAL IP version, different chip will use different version SERIAL IP.
endif
endchoice

if SUBSYS_AP
config PIN_WAKEUP
    bool "wakeup by pin function"
    default n

choice
    prompt "Select wakeup function"
    depends on PIN_WAKEUP
    default PIN_WAKEUP_EIPU
config PIN_WAKEUP_GPIO
    bool "enable wakeup by gpio"
    help
      Select gpio function for wakeup.

config PIN_WAKEUP_EIPU
    bool "enable wakeup by eipu"
    help
      Select gpio function for wakeup.
endchoice
endif

config DRIVER_GPIO_WAKEUP
    bool "enable GPIO wakeup"
    depends on DRIVER_UART
    default n
    help
      Add GPIO wakeup MCU for serial transfer.
config DRIVER_QUAD_PIN_WAKEUP
    bool "QUAD pin wakeup enable"
    default n
    help
      Enable quad pin wakeup.
endif
```

## aicos/drivers/sleep/Kconfig
```kconfig
# General configuration options
#
# Copyright 2021 by AICXTEK TECHNOLOGIES CO.,LTD. All rights reserved.

menuconfig DEEP_SLEEP
    bool "SLEEP Drivers"
    help
      Enable config options for SLEEP drivers.

if DEEP_SLEEP
choice
    prompt "sleep controller selection"
    default SLEEP_R1P0

    config SLEEP_R1P0
        bool "sleep r1p0"
        help
            gx31x sleep

    config SLEEP_R2P0
        bool "sleep r2p0"
        help
            gx30x sleep
endchoice

if SLEEP_R1P0
    config SLEEP_VERSION
        string
        default "r1p0"
endif

if SLEEP_R2P0
    config SLEEP_VERSION
        string
        default "r2p0"
endif

config SLP_AT
    bool "SLP AT CMD"
    default y

config CHECK_APLL
    bool "CHECK APLL"
    default y

endif

config DVFS
    bool "dvfs"
    default n
```

## aicos/drivers/sound/Kconfig
```kconfig
# General configuration options
#
# Copyright 2021 by AICXTEK TECHNOLOGIES CO.,LTD. All rights reserved.

menu "SOUND Configurations"

config SOUND_SUPPORT
    bool "Sound driver"
    default n
    select IIS
    select DRIVER_IIS
    help
        Enable sound feature, contains sound driver framework,
        stream driver and codec driver.

config SOUND_AIC_CODEC
    bool "AIC codec driver"
    default n
    depends on SOUND_SUPPORT
    help
        Enable AIC codec driver.

config SOUND_STREAM_IPC
    bool "stream thr IPC"
    default n
    depends on SOUND_SUPPORT
    select ADSP_MNG
    select SND_IPC
    help
        Enable AIC stream driver which transfer data throught IPC.

config SND_STREAM_CMUX
    bool "CMUX stream"
    default y
    depends on SOUND_SUPPORT && CMUX
    help
        Enable CMUX stream.

config SND_STREAM_VOICE_MIX
    bool "voice mix stream"
    default y
    depends on SOUND_SUPPORT && MCU_AUDIO_VOICE_CLIENT
    help
        Enable voice mix stream.

config SOUND_CODEC_ES8374
    bool "ES8374 codec driver"
    default n
    depends on SOUND_SUPPORT
    select DRIVER_I2C
    help
        ES8374 codec driver through which can play sound.

config SOUND_CODEC_ES8311
    bool "ES8311 codec driver"
    default n
    depends on SOUND_SUPPORT
    select DRIVER_I2C
    help
        ES8311 codec driver through which can play sound.

config SOUND_CODEC_ES8311_1V8
    bool "ES8311 codec 1v8"
    default n
    depends on SOUND_CODEC_ES8311
    help
        ES8311 codec work voltage select 1.8V.

config SOUND_CODEC_ES7243L
    bool "ES7243L codec driver"
    default n
    depends on SOUND_SUPPORT
    select DRIVER_I2C
    help
        ES7243L codec driver through which can play sound.

config SOUND_CODEC_CJC8910
    bool "CJC8910 codec driver"
    default n
    depends on SOUND_SUPPORT
    select DRIVER_I2C
    help
        CJC8910 codec driver through which can play sound.

config SOUND_CODEC_CJC8911
    bool "CJC8911 codec driver"
    default n
    depends on SOUND_SUPPORT
    select DRIVER_I2C
    help
        CJC8911 codec driver through which can play sound.

config SOUND_CODEC_NO_CTRL
    bool "no ctrl codec driver"
    default n
    depends on SOUND_SUPPORT
    help
        No control codec driver through which can play sound.

choice
    prompt "Select sound PA model"
    depends on SOUND_SUPPORT
    default SOUND_PA_NONE
    help
        select which sound PA model should be used.

    config SOUND_PA_NONE
        bool "none"
        help
            no PA.

    config SOUND_GPIO_CTRL_PA
        bool "GPIO control type PA"
        help
            "GPIO control type general PA"

    choice
        prompt "Select PA codec"
        depends on SOUND_GPIO_CTRL_PA
        default SOUND_PA_CODEC_NONE
        config SOUND_PA_CODEC_NONE
            depends on SOUND_GPIO_CTRL_PA
            bool "PA codec none"
            help
              123
        config SOUND_PA_CODEC_AUX
            depends on SOUND_GPIO_CTRL_PA
            bool "PA codec aux"
            help
              234
        config SOUND_PA_CODEC_MASTER
            depends on SOUND_GPIO_CTRL_PA
            bool "PA codec master"
            help
              345
    endchoice

    config SOUND_PA_AW87390
        select DRIVER_I2C
        bool "AW87390 PA"
        help
            AW87390 PA driver.

    config AW87390_PRIMARY_CODEC
        bool "AW87390 PA primary codec"
        default n
        depends on SOUND_PA_AW87390
        help
            AW87390 PA work as primary codec.

    config SOUND_PA_AW88261
        select DRIVER_I2C
        bool "AW88261 PA"
        help
            AW88261 dig PA driver.

    config SOUND_PA_HAA9210
        bool "HAA9210 PA"
        help
            HAA9210 PA driver.
endchoice

config SOUND_BIAS_DVDD3V
    bool "Micbias use DVDD3V"
    default n
    depends on SOUND_SUPPORT
    help
        Micbias use DVDD3V.

config SND_IPC
    bool "sound ipc"
    default n
    help
        Enable sound ipc module

config ADSP_MNG
    bool "ADSP manager"
    default n
    select SND_IPC
    help
        Enable adsp manager module

config ADSP_LOG
    bool "ADSP log"
    default n
    depends on ADSP_MNG
    help
        Enable adsp log feature.

config ADSP_DUMP
    bool "ADSP dump"
    default n
    depends on ADSP_MNG
    help
        Enable adsp dump feature.

config MUSIC_FIX_48K
    bool "MUSIC FIX 48K"
    default y
    depends on SOUND_SUPPORT
    help
        Enable DSP music play fix to 48K sample rate.

config RECORD_FIX_16K
    bool "RECORD FIX 16K"
    default y
    depends on SOUND_SUPPORT
    help
        Enable DSP record fix to 16K sample rate.

config SOUND_CONV
    bool "data convert output"
    default n
    depends on SOUND_SUPPORT
    help
        Enable data convert output feature.

config VOICE_TRANS
    bool "Voice Trans"
    default n
    depends on SND_IPC
    help
        Voice data transfer API.

config SND_SIMU
    bool "Sound SIMU"
    default n
    help
        Enable simu about sound module.

config VOICE_SIMU
    bool "Voice SIMU"
    default n
    depends on SND_SIMU
    help
        Enable voice data transfer simu.

endmenu # CSP Configurations
```

## aicos/drivers/spinlock/Kconfig
```kconfig
# General configuration options
#
# Copyright 2022 by AICXTEK TECHNOLOGIES CO.,LTD. All rights reserved.

menuconfig SPINLOCK
    bool "SoC SPINLOCK Drivers"
    help
      Enable config options for spinlock drivers.

if SPINLOCK

config DRIVER_SPINLOCK
    bool "Soc spinlock driver"
    default y
    help
      Soc spinlock module driver.

endif
```

## aicos/drivers/ssp/Kconfig
```kconfig
# General configuration options
#
# Copyright 2021 by AICXTEK TECHNOLOGIES CO.,LTD. All rights reserved.
#

menuconfig SSP
    bool "SSP Drivers"
    help
        This enables support for the SSP controller.

if SSP

config SSP_DRIVER
    bool "Driver SSP module"
    default n
    help
      Select SSP module.

config SSP_DRIVER_VER
    string "SSP IP version"
    depends on SSP_DRIVER
    default "r1p0"
    help
      SSP IP version, different chip will use different version SSP IP.

endif
```
