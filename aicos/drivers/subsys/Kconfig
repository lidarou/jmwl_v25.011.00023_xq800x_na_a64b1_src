## aicos/mm/audio/Kconfig
```kconfig
# General configuration options
#
# Copyright 2021 by AICXTEK TECHNOLOGIES CO.,LTD. All rights reserved.

menu "Audio Configurations"

config AUDIO_SUPPORT
    bool "MM Audio support"
    default n
    help
        Enable audio feature, mainly contains audio framework,
        include play, record, nv, eng moduel, etc.

config MCU_AUDIO
    bool "MCU AUDIO"
    default n
    depends on AUDIO_SUPPORT
    help
        Enable audio get voice data directly.

config VOICE_EFFECT
    bool
    default n
    depends on MCU_AUDIO
    help
        Enable voice effect.

config MCU_AUDIO_VOICE_CLIENT
    bool "MCU audio voice client"
    default n
    depends on MCU_AUDIO
    select VOICE_EFFECT
    select SND_STREAM_VOICE_MIX
    help
        Enable ap voice client.

config MCU_AUDIO_VOIP_CLIENT
    bool "MCU audio voip client"
    default n
    depends on MCU_AUDIO
    select VOICE_EFFECT
    help
        Enable ap voip client.

config PLAYBACK_EFFECT
    bool "playback effect"
    default y
    depends on MCU_AUDIO
    help
        Enable audio playback effect.

config REC_EFFECT
    bool "record effect"
    default y
    depends on MCU_AUDIO
    help
        Enable audio record effect.

choice
    prompt "lib type selection"
    default AUDIO_LIB_NORMAL
    depends on AUDIO_SUPPORT
    config AUDIO_LIB_EXT
        bool "lib ext"
        help
            audio lib extend instrument.

    config AUDIO_LIB_NORMAL
        bool "lib normal"
        help
            audio lib normal.
endchoice

config TONE_SUPPORT
    bool "MM Tone support"
    default n
    depends on AUDIO_SUPPORT
    help
        Enable tone generator.

config VOICE_STREAM
    bool "voice stream"
    default n
    depends on AUDIO_SUPPORT && CMUX
    help
        Enable AP get snd send voice stream.

config FS_AUDIO_SUPPORT
    bool "play and record by file system"
    default y
    depends on AUDIO_SUPPORT && FS
    help
        Enable play thr and record to file.

config SAVE_REC_FILE_ASYNC
    bool "Save record file async"
    default n
    depends on AUDIO_SUPPORT && FS_AUDIO_SUPPORT
    help
        Save record file async.

config VOICE_ACC
    bool "voice accelarator"
    default n
    depends on AUDIO_SUPPORT
    help
        Enable voice accelarator.

config VOLUME_NO_CODEC
    bool "volume no codec"
    default n
    depends on AUDIO_SUPPORT
    help
        Volume no codec.

config AUDIO_AT_COMM
    bool "common audio AT command"
    default n
        depends on AUDIO_SUPPORT
    help
        common audio AT command.
config AUDIO_AT_DTMF
    bool "Audio DTMF"
    default n
        depends on AUDIO_AT_COMM
    help
        Audio DTMF AT command.
config AUDIO_AT_D2D
    bool "D2D"
    default n
        depends on AUDIO_AT_COMM
        select VOICE_SRATE_DYNAMIC
    help
        D2D audio AT command.

config AUDIO_AT_CMIOT
    bool "CMOIT audio AT command"
    default n
        depends on AUDIO_SUPPORT
    help
        audio CMIOT AT command.

config AUDIO_STREAM_TEST
    bool "audio stream test"
    default n
    depends on AUDIO_SUPPORT
    help
        Enable audio stream play and record test.

config NV_SUPPORT
    bool "audio nv support"
    default n
    depends on AUDIO_SUPPORT
    help
        Audio NV.

config AUDIO_NV_TEST
    bool "audio nv test"
    default n
    depends on NV_SUPPORT
    help
        Enable audio nv read and write.

config VOLTE_SIMU_TEST
    bool "volte simu test"
    default n
    depends on AUDIO_SUPPORT && AUDIO_SUPPORT
    help
        Enable volte simulator.

config ADSP_EDA_MP3
    bool "ADSP EDA mp3 test"
    default n
    depends on AUDIO_SUPPORT
    help
        Enable ADSP EDA MP3.

config AUDIO_TTS
    bool "AUDIO TTS"
    default n
    depends on AUDIO_SUPPORT
    help
        ENABLE AUDIO TTS.

choice
    prompt "seletct music resource"
    default FILE_NONE
        depends on AUDIO_SUPPORT
    help
      Select music resoruce.

    config FILE_NONE
        bool "NONE"
        help
          No resource.

    config PCM_48K_MONO
        bool "PCM 48K MONO"
        help
          PCM 48k mono resource.

    config PCM_16K_MONO
        bool "PCM 16K MONO"
        help
          PCM 16k mono resource.

    config PCM_8K_MONO
        bool "PCM 8K MONO"
        help
          PCM 16k mono resource

    config PCM_48K_DUAL
        bool "PCM 48K MONO"
        help
          PCM 48k dual resource.

    config PCM_16K_DUAL
        bool "PCM 16K DUAL"
        help
          PCM 16k dual resource.

    config PCM_8K_DUAL
        bool "PCM 8K DUAL"
        help
          PCM 8K DUAL resource.

    config MP3_NORMAL
        bool "MP3 normal"
        help
          MP3 normal resource.

    config MP3_8K_MONO
        bool "MP3 8K MONO"
        help
          MP3 8k mono resource.

    config CHIRP_48K_MP3
        bool "CHIRP 48K MP3"
        help
          CHIRT 48K MP3.

    config CHIRP_48K_WAV
        bool "CHIRP 48K WAV"
        help
          CHIRP 48K WAV.

    config MIDI_FILE
        bool "MIDI"
        help
          MIDI resource.
endchoice

config VOLTE_SIMU
    bool "volte simu"
    default n
    depends on AUDIO_SUPPORT
    help
        Enable volte simulator.

if AUDIO_LIB_EXT
    config AUDIO_LIB_TYPE
        string
        default "lib_ext"
endif

if AUDIO_LIB_NORMAL
    config AUDIO_LIB_TYPE
        string
        default "lib"
endif

config VOICE_SRATE_DYNAMIC
    bool
    default n
    depends on AUDIO_SUPPORT
    help
        Enable voice rate set dynamic
endmenu
```

## aicos/mm/camera/Kconfig
```kconfig
# General configuration options
#
# Copyright 2021 by AICXTEK TECHNOLOGIES CO.,LTD. All rights reserved.

menu "Camera Configurations"

config CAMERA_SUPPORT
    bool "MM Camera support"
    default y
    help
        Enable camera support.

config CSI_SUPPORT
    bool "CSI Driver Support"
    default y
    depends on CAMERA_SUPPORT
    help
        Enable CSI Driver

config GX316_CSI
    bool "GX316 CSI Driver"
    default y
    depends on CSI_SUPPORT
    help
        Enable GX316 CSI Driver.

config CAMERA_SENSOR_SUPPORT
    bool "Camera Sensor Driver Support"
    default y
    depends on CAMERA_SUPPORT
    help
        Enable Camera Sensor Driver

config CAMERA_SENSOR_GC032A
    bool "Sensor Gc032a support"
    default y
    depends on CAMERA_SENSOR_SUPPORT && DRIVER_I2C
    help
        Enable sensor gc032a

config CAMERA_SENSOR_BF20A6
    bool "Sensor bf20a6 support"
    default n
    depends on CAMERA_SENSOR_SUPPORT && DRIVER_I2C
    help
        Enable sensor bf20a6

config CAMERA_SENSOR_BF30A2
    bool "Sensor bf30a2 support"
    default n
    depends on CAMERA_SENSOR_SUPPORT && DRIVER_I2C
    help
        Enable sensor bf30a2

config CAMERA_SENSOR_BF3901UCS
    bool "Sensor bf3901ucs support"
    default n
    depends on CAMERA_SENSOR_SUPPORT && DRIVER_I2C
    help
        Enable sensor bf3901ucs

config CAMERA_SENSOR_GC6133
    bool "Sensor Gc6133 support"
    default n
    depends on CAMERA_SENSOR_SUPPORT && DRIVER_I2C
    help
        Enable sensor gc6133

config CAMERA_VIDEO_SUPPORT
    bool "Camera video support"
    depends on CAMERA_SUPPORT
    default n
    help
        Enable Camera Video support

config CAMERA_AT_CMD_SUPPORT
    bool "Camera At Command Support"
    default n
    depends on CAMERA_SUPPORT && AT_PROC
    help
        Enable camera at command

config CAMERA_OPEN_BY_DEFAULT
    bool "Camera open by default"
    default n
    depends on CAMERA_SUPPORT
    help
        Camera open by default

config JPEG_SUPPORT
    bool "JPEG Driver Support"
    default n
    depends on CAMERA_SUPPORT
    help
        Enable JPEG Driver

config LIBJPEG_SUPPORT
    bool "LIBJPEG Driver Support"
    default n
    depends on JPEG_SUPPORT
    help
        Enable LIBJPEG Driver

config LIBJPEG_DECODER_SUPPORT
    bool "Libjpeg Decoder Support"
    default n
    depends on LIBJPEG_SUPPORT
    help
        Enable Libjpeg Decoder Support

config LIBJPEG_ENCODER_SUPPORT
    bool "Libjpeg Encoder Support"
    default n
    depends on LIBJPEG_SUPPORT
    help
        Enable Libjpeg Encoder Support

config LIBJPEG_AIC_EXAMPLE_SUPPORT
    bool "Libjpeg aic example support"
    default n
    depends on LIBJPEG_SUPPORT
    help
        Libjpeg aic example support

#config LIBJPEG_TURBO_SUPPORT
#    bool "LIBJPEG Turbo Driver Support"
#    default n
#    depends on JPEG_SUPPORT
#    help
#        Enable LIBJPEG Turbo Driver

endmenu
```

## aicos/mm/codec/Kconfig
```kconfig
# General configuration options
#
# Copyright 2021 by AICXTEK TECHNOLOGIES CO.,LTD. All rights reserved.

menu "codec Configurations"

config SW_CODEC_SUPPORT
    bool "sw codec support"
    default n
    help
        Enable sw codec

config HW_CODEC_SUPPORT
    bool "hw codec support"
    default n
    help
        Enable hw codec

config CODEC_HW_SPECIAL
    bool "hw special support"
    default n
    help
        Enable hw special codec

config WAV_SUPPORT
    bool "wav support"
    default n
    help
        Enable wav codec.

config MP3_SUPPORT
    bool "mp3 support"
    default n
    help
        Enable mp3 codec.

config DEC_CODEC_MP3_COMPR
    bool "dec compress support"
    default y
    depends on MP3_SUPPORT
    help
        Enable compress codec for mp3 decoder

config DEC_CODEC_MP3_HWCODEC
    bool "dec hwcodec support"
    default n
    depends on MP3_SUPPORT
    depends on HW_CODEC_SUPPORT
    help
        Enable hwcodec for mp3 decoder

config DEC_CODEC_MP3_AD
    bool "dec adcodec support"
    default n
    depends on MP3_SUPPORT
    depends on SW_CODEC_SUPPORT
    help
        Enable ad mp3 codec for mp3 decoder

config AMR_SUPPORT
    bool "amr support"
    default n
    help
        Enable amr codec.

config DEC_CODEC_AMR_COMPR
    bool "dec compress support"
    default y
    depends on AMR_SUPPORT
    help
        Enable compress codec for amr decoder

config DEC_CODEC_AMR_AD
    bool "dec ad support"
     default n
     depends on AMR_SUPPORT
     depends on SW_CODEC_SUPPORT
     help
        Enable ad codec for amr decoder

config DEC_CODEC_AMR_NB_AD
    bool "amr nb"
    default n
    depends on DEC_CODEC_AMR_AD
    help
        Enable ad codec for amr nb decoder

config DEC_CODEC_AMR_WB_AD
    bool "amr wb"
    default n
    depends on DEC_CODEC_AMR_AD
    help
        Enable ad codec for amr wb decoder

config ENC_CODEC_AMR_COMPR
    bool "enc compress support"
    default y
    depends on AMR_SUPPORT
    help
        Enable compress codec for amr encoder

config ENC_CODEC_AMR_AD
    bool "enc ad support"
     default n
     depends on AMR_SUPPORT
     depends on SW_CODEC_SUPPORT
     help
        Enable ad codec for amr encoder

config ENC_CODEC_AMR_NB_AD
    bool "amr nb"
    default n
    depends on ENC_CODEC_AMR_AD
    help
        Enable ad codec for amr nb encoder

config ENC_CODEC_AMR_WB_AD
    bool "amr wb"
    default n
    depends on ENC_CODEC_AMR_AD
    help
        Enable ad codec for amr wb encoder

config VOICE_DTMF
    bool "voice DTMF"
    default n
    depends on SW_CODEC_SUPPORT
    help
        Enable voice DTMF

config MIDI_SUPPORT
    bool "midi support"
    default n
    help
        Enable midi codec.

config MIDI_TEST_SUPPORT
    bool "midi test support"
    default n
    depends on MIDI_SUPPORT
    help
        Enable midi codec test.

choice
    prompt "midi level"
    default MIDI_LOW
    depends on MIDI_SUPPORT
    help
      Select MIDI quality level, the quality is higher the size is bigger.

    config MIDI_HIGH
        bool "High quality midi"
        help
          Hight quality midi liberary.

    config MIDI_MID
        bool "Mid quality midi"
        help
          Middle quality midi liberary.

    config MIDI_LOW
        bool "Low quality midi"
        help
          Low quality midi liberary.
endchoice

endmenu # Drivers Configurations
```

## aicos/mm/codec/midi/Kconfig
```kconfig
# General configuration options
#
# Copyright 2021 by AICXTEK TECHNOLOGIES CO.,LTD. All rights reserved.

menu "codec Configurations"

config MIDI_SUPPORT
    bool "midi support"
    default n
    help
        Enable midi codec.

config MIDI_TEST_SUPPORT
    bool "midi test support"
    default n
    depends on MIDI_SUPPORT
    help
        Enable midi codec test.
choice
    prompt "midi level"
    default MIDI_LOW
    depends on MIDI_SUPPORT
    help
      Select MIDI quality level, the quality is higher the size is bigger.

    config MIDI_HIGH
        bool "High quality midi"
        help
          Hight quality midi liberary.

    config MIDI_MID
        bool "Mid quality midi"
        help
          Middle quality midi liberary.

    config MIDI_LOW
        bool "Low quality midi"
        help
          Low quality midi liberary.
endchoice

endmenu # Drivers Configurations
```

## aicos/os/kernel/threadx/utility/rtos_compatibility_layers/Kconfig
```kconfig
menu "POSIX Options"
source "os/kernel/threadx/utility/rtos_compatibility_layers/posix/Kconfig"
endmenu
```

## aicos/os/kernel/threadx/utility/rtos_compatibility_layers/posix/Kconfig
```kconfig
menu "POSIX Config"
    config AIC_POSIX
        bool "AIC Posix Enable"
        default y
        help
          Enable use the posix.
          if enable it， will use posix libc.


    config AIC_POSIX_TEST
        bool "AIC POSIX TEST Enable"
        depends on AIC_POSIX
        default n
        help
        Enable AIC POSIX test function.

endmenu
```

## aicos/os/osa/Kconfig
```kconfig
menu "Osa Options"
source "os/osa/common/Kconfig"
source "os/osa/rae_libc/Kconfig"
source "os/osa/rom_call/Kconfig"
endmenu
```
