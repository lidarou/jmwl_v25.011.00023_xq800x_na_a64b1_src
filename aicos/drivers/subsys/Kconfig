## aicos/drivers/subsys/Kconfig
```kconfig
# General configuration options
#
# Copyright 2021 by AICXTEK TECHNOLOGIES CO.,LTD. All rights reserved.

menuconfig SUBSYS_CTRL
    bool "Subsys Ctrl Drivers"
    default n
    help
      Enable config options for Subsys Ctrl drivers.

if SUBSYS_CTRL

config DRIVER_SUBSYS_CTRL
    bool "Subsys ctrl driver"
    default n

endif
```

## aicos/drivers/sysoff/Kconfig
```kconfig
menu "SYSOFF Config"
    config AIC_SYSOFF
        bool "AIC SYSOFF Enable"
        depends on SUBSYS_AP && PMIC_I2C
	select DRIVER_WDT
        default y
        help
          Enable SYSOFF process for ap
          if enable it, will use sysoff

    config AIC_SYSOFF_AT
        bool "AIC SYSOFF for AT COMMAND"
	depends on AIC_SYSOFF
	default n
	help
	  Enable SYSOFF process for at command
	  if enable it, will use sysoff

    config AIC_SYSOFF_CHARGE
        bool "AIC Charge process while system off"
        depends on AIC_SYSOFF
        default n
        help
          Enable charging while system off.
          if enable it, will use sysoff
endmenu
```

## aicos/drivers/thermc/Kconfig
```kconfig
# General configuration options
#
# Copyright 2022 by AICXTEK TECHNOLOGIES CO.,LTD. All rights reserved.
menu "THERMC Configurations"

config DRIVER_THERMC
    bool "THERMC driver"
    depends on SUBSYS_AP
    default n
    help
      Monitor system temperature.

if DRIVER_THERMC
# AIC SoC therm controller Selection configurations
choice
    prompt "THERMC Selection"
    default THERMC_GX316

    config THERMC_GX316
        bool "gx316 therm controller."
        help
            gx316 therm controller.
endchoice

if THERMC_GX316
    config THERMC_VER
        string
        default "gx316"
endif

# AIC SoC therm Sensor Selection configurations
choice
    prompt "Therm Sensor Selection"
    default THERM_SENSOR_GX316_RF

    config THERM_SENSOR_GX316_RF
        bool "gx316 rf therm sensor."
        help
            gx316 rf therm sensor.
endchoice

if THERM_SENSOR_GX316_RF
    config THERM_SENSOR_VER
        string
        default "gx316_rf"
endif
endif
endmenu # thermal Configurations
```

## aicos/drivers/timer/Kconfig
```kconfig
# General configuration options
#
# Copyright 2021 by AICXTEK TECHNOLOGIES CO.,LTD. All rights reserved.

menu "Timer Drivers"

config DRIVER_TIMER
    bool "Timer driver"
    default n
    help
      Timer IP, use for schedule or timestamp

config DRIVER_TIMER_VER
    string "Timer driver IP version"
    depends on DRIVER_TIMER
    default "r1p0"
    help
      Timer IP version, different chip will use different version timer IP.

config TIMER_TX_NO_TICK_IRQ
    bool "Timer no tick irq"
#   depends on DRIVER_TIMER
    depends on RTOS_THREADX
    default n
    help
      Threadx use systimer for timer, instand of systick irq.

config TIMER_TX_NO_TICK_DBG
    bool "Timer no tick dbg"
    depends on TIMER_TX_NO_TICK_IRQ
    depends on RTOS_THREADX
    default n
    help
      Add threadx timer debug fucntions, used to store timer parameters.

endmenu # Timer Drivers
```

## aicos/drivers/trng/Kconfig
```kconfig
config AIC_TRNG
    bool "aic trng module"
    default n
    help
      "enable aic trng module"
```

## aicos/drivers/usb/Kconfig
```kconfig
# General configuration options
#
# Copyright 2021 by AICXTEK TECHNOLOGIES CO.,LTD. All rights reserved.

menuconfig USB
    bool "USB Drivers"
    depends on SUBSYS_AP
    default n
    help
      Enable config options for USB drivers.

if USB
config AZURE_USBX
    bool "USBX stack support"
    default n

# usb device configurations
config USBX_DEVICE
    bool "USBX device mode support"
    depends on AZURE_USBX
    default n

config USBX_DEVICE_STACK
    bool "USBX device stack support"
    depends on USBX_DEVICE
    default n

config USBX_DEVICE_SIMLATOR
    bool "USBX device stack simlator support"
    depends on USBX_DEVICE
    default n

config USBX_DEVICE_CLASS_DPUMP
    bool "USBX device class dpump support"
    depends on USBX_DEVICE
    default n

config USBX_DEVICE_CLASS_CDC_ACM
    bool "USBX device class cdc/acm support"
    depends on USBX_DEVICE

config USBX_DEVICE_CLASS_CDC_ECM
    bool "USBX device class cdc/ecm support"
    depends on USBX_DEVICE

config USBX_DEVICE_CLASS_RNDIS
    bool "USBX device class rndis support"
    depends on USBX_DEVICE

config USBX_DEVICE_CLASS_PIMA
    bool "USBX device class pima support"
    depends on USBX_DEVICE

config USBX_DEVICE_CLASS_HID
    bool "USBX device class hid support"
    depends on USBX_DEVICE

config USBX_DEVICE_CLASS_DFU
    bool "USBX device class dfu support"
    depends on USBX_DEVICE

config USBX_DEVICE_CLASS_STORAGE
    bool "USBX device class storage support"
    depends on USBX_DEVICE

config USBX_DEVICE_CLASS_AUDIO
    bool "USBX device class audio support"
    depends on USBX_DEVICE

# usb host configurations
config USBX_HOST
    bool "USBX host mode support"
    depends on AZURE_USBX
    default n

config USBX_HOST_STACK
    bool "USBX host stack support"
    depends on USBX_HOST
    default n

config USBX_HOST_SIMLATOR
    bool "USBX host stack simlator support"
    depends on USBX_HOST
    default n

config USBX_HOST_CLASS_DPUMP
    bool "USBX host class dpump support"
    depends on USBX_HOST
    default n

config USBX_NETWORK
    bool "USBX network support"
    depends on AZURE_USBX
    default n

config USB_AIC
    bool "AIC USB support"
    default n

config USB_DETECT_BCD
    bool "AIC USB BCD detect support"
    depends on USB_AIC
    default n

config USB_DETECT_GPIO
    bool "AIC USB GPIO detect support"
    depends on USB_AIC
    default n

endif # USB Configurations
```

## aicos/drivers/wdt/Kconfig
```kconfig
# General configuration options
#
# Copyright 2022 by AICXTEK TECHNOLOGIES CO.,LTD. All rights reserved.
menu "watchdog Configurations"

config DRIVER_WDT
    bool "watchdog timer driver"
    default n
    help
      Monitor system scheduling exceptions via wdt.

config DRIVER_WDT_VER
    string "wdt driver version"
    depends on DRIVER_WDT
    default "r1p0"
    help
      Select version that match witch SoC wdt IP.

config DRIVER_WDT_PMIC
    bool "PMIC watchdog driver"
    depends on DRIVER_WDT
    default n
    help
      Use PMIC wdt monitor SoC completely hungup.

config WATCHDOG_INDEPENDENT_THREAD
    bool "watchdog independent thread"
    depends on DRIVER_WDT
    default y
    help
      Create watchdog independent thread for system exception monitoring.

config WDT_RETENTION
    bool "watchdog config suspend/resume retention"
    depends on DRIVER_WDT
    default n
    help
      watchdog config suspend/resume retention.

if WATCHDOG_INDEPENDENT_THREAD
    # AIC SoC wdt work mode Selection configurations
    choice
        prompt "wdt work mode Selection"
        default WDT_MODE_HYBRID

        config WDT_MODE_IRQ
            bool "wdt work mode irq only"
            help
                select wdt work mode irq only.

        config WDT_MODE_HYBRID
            bool "wdt work mode irq & reset"
            help
                select wdt work mode irq & reset.
    endchoice

    if WDT_MODE_IRQ
        config WDT_WORK_MODE
            int
            default 0
    endif

    if WDT_MODE_HYBRID
        config WDT_WORK_MODE
            int
            default 2
    endif
endif

config SW_WATCHDOG_MONITOR
    bool "Low Priority Task scheduling exception monitor"
    depends on SUBSYS_AP
    default n
    help
      Create Software Watchdog for Low priority task scheduling exception monitor.
endmenu # watchdog Configurations
```

## aicos/drivers/zjtag/Kconfig
```kconfig
# General configuration options
#
# Copyright 2021 by AICXTEK TECHNOLOGIES CO.,LTD. All rights reserved.

menuconfig ZJTAG
    bool "ZJTAG Drivers"
    depends on SUBSYS_AP
    help
      Enable config options for zjtag drivers.

if ZJTAG

config DRIVER_ZJTAG
    bool "Driver ZJtag"
    default n
    help
      Select zjtag module.

config DRIVER_ZJTAG_VER
    string "ZJTAG driver IP version"
    depends on DRIVER_ZJTAG
    default "r1p0"
    help
      ZJTAG IP version, different chip will use different version
      of zjtag IP.

endif
```

## aicos/drivers/zz_test/Kconfig
```kconfig
# General configuration options
#
# Copyright 2021 by AICXTEK TECHNOLOGIES CO.,LTD. All rights reserved.

menu "Drivers Test Configurations"

config DRIVER_TEST
    bool "Test driver"
    default n
    help
      Select driver test function.Note, it should not be selected
      normally.

# source test driver components kconfig
source "drivers/zz_test/example/Kconfig"
source "drivers/zz_test/lzma/Kconfig"
source "drivers/zz_test/fmd/Kconfig"
source "drivers/zz_test/ftl/Kconfig"
source "drivers/zz_test/serial/Kconfig"
source "drivers/zz_test/memdfs/Kconfig"
source "drivers/zz_test/ssp/Kconfig"

endmenu # Drivers Test Configurations
```

## aicos/drivers/zz_test/example/Kconfig
```kconfig
# General configuration options
#
# Copyright 2021 by AICXTEK TECHNOLOGIES CO.,LTD. All rights reserved.

# driver example test configurations
config EXAMPLE_UT
    bool "Unit test of example"
    depends on DRIVER_TEST && DRIVER_EXAMPLE
    help
      Select example driver unit test function.
```

## aicos/drivers/zz_test/fmd/Kconfig
```kconfig
# General configuration options
#
# Copyright 2021 by AICXTEK TECHNOLOGIES CO.,LTD. All rights reserved.

# fmd test configurations
config FMD_UT
    bool "Unit test of FMD"
    depends on DRIVER_TEST && FMD
    help
      Select FMD unit test function.
```

## aicos/drivers/zz_test/ftl/Kconfig
```kconfig
# General configuration options
#
# Copyright 2021 by AICXTEK TECHNOLOGIES CO.,LTD. All rights reserved.

# ftl test configurations
config FTL_UT
    bool "Unit test of FTL"
    depends on DRIVER_TEST && FTL
    help
      Select FTL unit test function.
```

## aicos/drivers/zz_test/memdfs/Kconfig
```kconfig
# General configuration options
#
# Copyright 2021 by AICXTEK TECHNOLOGIES CO.,LTD. All rights reserved.

# memdfs test configurations
config MEMDFS_UT
    bool "Unit test of memory dfs"
    depends on DRIVER_TEST && PSRAM && SNC_QSPI
    help
      Select memory dfs unit test function.
```

## aicos/drivers/zz_test/serial/Kconfig
```kconfig
# General configuration options
#
# Copyright 2021 by AICXTEK TECHNOLOGIES CO.,LTD. All rights reserved.

# serial test configurations
config SERIAL_UT
    bool "Unit test of SERIAL"
    depends on DRIVER_TEST && DRIVER_UART_AIC
    help
      Select SERIAL unit test function.
```

## aicos/drivers/zz_test/ssp/Kconfig
```kconfig
# General configuration options
#
# Copyright 2021 by AICXTEK TECHNOLOGIES CO.,LTD. All rights reserved.

# ssp test configurations
config SSP_UT
    bool "Unit test of SSP"
    depends on DRIVER_TEST && SSP
    help
      Select SSP unit test function.
```

## aicos/mm/Kconfig
```kconfig
# General configuration options
#
# Copyright 2021 by AICXTEK TECHNOLOGIES CO.,LTD. All rights reserved.

menuconfig MM
    bool "Multi Media Options"
    depends on SUBSYS_AP
    help
      Enable config options for Multi Media.

if MM

source "mm/audio/Kconfig"
source "mm/codec/Kconfig"
source "mm/camera/Kconfig"

endif # MM Options
```
